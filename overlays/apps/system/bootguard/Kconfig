## profiles/fruit-jam-network/defconfig
```kconfig
# NuttX RP2350: Adafruit Fruit Jam low-footprint ESP-Hosted network profile

CONFIG_ALLOW_BSD_COMPONENTS=y
CONFIG_ARCH="arm"
CONFIG_ARCH_BOARD="adafruit-fruit-jam-rp2350"
CONFIG_ARCH_BOARD_ADAFRUIT_FRUIT_JAM_RP2350=y
CONFIG_ARCH_BOARD_COMMON=y
CONFIG_ARCH_CHIP="rp23xx"
CONFIG_ARCH_CHIP_RP23XX=y
CONFIG_ARCH_INTERRUPTSTACK=2048
CONFIG_ARCH_RAMVECTORS=y
CONFIG_ARCH_SETJMP_H=y
CONFIG_ARCH_STACKDUMP=y
CONFIG_ARCH_TOOLCHAIN_GCC=y
CONFIG_ARCH_TOOLCHAIN_GNU=y
CONFIG_ARM_TOOLCHAIN_GNU_EABI=y
CONFIG_BOARD_LOOPSPERMSEC=10450
CONFIG_BOARDCTL_RESET=y
CONFIG_BUILTIN=y
CONFIG_DEFAULT_TASK_STACKSIZE=4096
CONFIG_RR_INTERVAL=10
CONFIG_IDLETHREAD_STACKSIZE=2048
CONFIG_INIT_ENTRYPOINT="nsh_main"
CONFIG_INIT_STACKSIZE=8192
CONFIG_RAM_START=0x20000000
CONFIG_RAM_SIZE=532480
CONFIG_RP23XX_RP2350B=y
# CONFIG_RP23XX_UART0 is not set
# CONFIG_DEV_CONSOLE is not set

CONFIG_USBDEV=y
CONFIG_USBDEV_BUSPOWERED=y
CONFIG_CDCACM=y
CONFIG_CDCACM_CONSOLE=y
CONFIG_CDCACM_DISABLE_TXBUF=y
CONFIG_CDCACM_BOOTSEL_TOUCH=y
CONFIG_CDCACM_BOOTSEL_TOUCH_RESET_STATUS=3
CONFIG_SERIAL_TERMIOS=y
CONFIG_TTY_SIGINT=y
CONFIG_TTY_SIGINT_CHAR=0x03
CONFIG_SCHED_HPWORK=y
CONFIG_SCHED_LPWORK=y
CONFIG_SCHED_LPWORKPRIORITY=80
CONFIG_SCHED_WAITPID=y
CONFIG_SIG_DEFAULT=y

CONFIG_FS_PROCFS=y
CONFIG_FS_PROCFS_REGISTER=y
CONFIG_FS_TMPFS=y
CONFIG_FS_ROMFS=y
CONFIG_ETC_ROMFS=y
CONFIG_ETC_ROMFSDEVNO=1
CONFIG_FS_FAT=y
CONFIG_FS_FATTIME=y
CONFIG_FAT_LFN=y
CONFIG_FAT_LCNAMES=y
CONFIG_FSUTILS_MKFATFS=y
CONFIG_FSUTILS_PASSWD=y
CONFIG_FSUTILS_PASSWD_PATH="/mnt/sd0/telnet.passwd"
CONFIG_FSUTILS_PASSWD_KEY1=0xca095467
CONFIG_FSUTILS_PASSWD_KEY2=0x485258bc
CONFIG_FSUTILS_PASSWD_KEY3=0xd7672dbe
CONFIG_FSUTILS_PASSWD_KEY4=0x4b8f238b
CONFIG_MBR_PARTITION=y
CONFIG_MMCSD=y
CONFIG_MMCSD_PROCFS=y
CONFIG_MMCSD_IDMODE_CLOCK=200000
CONFIG_MMCSD_MULTIBLOCK_LIMIT=1
CONFIG_LIBC_PERROR_STDOUT=y
CONFIG_LIBC_STRERROR=y
CONFIG_NFILE_DESCRIPTORS_PER_BLOCK=12
CONFIG_LINE_MAX=256

CONFIG_NSH_BUILTIN_APPS=y
CONFIG_NSH_FILEIOSIZE=512
CONFIG_NSH_READLINE=y
CONFIG_NSH_STRERROR=y
CONFIG_NSH_USBCONSOLE=y
CONFIG_NSH_USBCONSOLE_CONNECT_DELAY=500
CONFIG_NSH_USBCONSOLE_WAIT_DTR=y
CONFIG_NSH_USBCONSOLE_WAIT_DTR_TIMEOUT=5000
# CONFIG_NSH_USBCONSOLE_WAIT_INPUT is not set
# CONFIG_NSH_DISABLE_IFCONFIG is not set
# CONFIG_NSH_DISABLE_DATE is not set
# CONFIG_NSH_DISABLE_PASSWD is not set
# CONFIG_NSH_DISABLE_USERADD is not set
# CONFIG_NSH_DISABLE_USERDEL is not set
# CONFIG_NSH_DISABLE_WGET is not set
CONFIG_NSH_TELNET_LOGIN=y
CONFIG_NSH_LOGIN_PASSWD=y
CONFIG_NSH_LOGIN_FAILDELAY=1000
CONFIG_NSH_LOGIN_FAILCOUNT=3
CONFIG_READLINE_TABCOMPLETION=y
CONFIG_READLINE_CMD_HISTORY=y
CONFIG_READLINE_CMD_HISTORY_LINELEN=256
CONFIG_READLINE_CMD_HISTORY_LEN=32

CONFIG_INTERPRETERS_BERRY=y
CONFIG_INTERPRETERS_BERRY_STACKSIZE=8192
CONFIG_SYSTEM_NSH=y
CONFIG_SYSTEM_NSH_STACKSIZE=8192
CONFIG_SYSTEM_VI=y
CONFIG_SYSTEM_VI_COLS=80
CONFIG_SYSTEM_VI_ROWS=24
CONFIG_SYSTEM_VI_STACKSIZE=4096
CONFIG_SYSTEM_I2CTOOL=y
CONFIG_SYSTEM_DUMPSTACK=y
CONFIG_SYSTEM_SYSTEM=y
CONFIG_SYSTEM_BOOTSEL=y

CONFIG_RP23XX_I2C=y
CONFIG_RP23XX_I2C0=y
CONFIG_RP23XX_I2C0_SDA_GPIO=20
CONFIG_RP23XX_I2C0_SCL_GPIO=21
CONFIG_RP23XX_I2C_DRIVER=y
CONFIG_RP23XX_SPI=y
CONFIG_RP23XX_SPI0=y
CONFIG_RP23XX_SPI0_RX_GPIO=36
CONFIG_RP23XX_SPI0_CS_GPIO=39
CONFIG_RP23XX_SPI0_SCK_GPIO=34
CONFIG_RP23XX_SPI0_TX_GPIO=35
CONFIG_RP23XX_SPI1=y
CONFIG_RP23XX_SPI1_RX_GPIO=28
CONFIG_RP23XX_SPI1_CS_GPIO=46
CONFIG_RP23XX_SPI1_SCK_GPIO=30
CONFIG_RP23XX_SPI1_TX_GPIO=31
CONFIG_ADAFRUIT_FRUIT_JAM_SD_SPI=y
CONFIG_RP23XX_SPISD=y
CONFIG_RP23XX_SPISD_AUTOMOUNT=y
CONFIG_RP23XX_SDCARD_AUTOMOUNT=y
CONFIG_MMCSD_SPICLOCK=4000000
CONFIG_MMCSD_SPIRETRY_COUNT=3
CONFIG_SYSTEM_SDMOUNT=y
CONFIG_SYSTEM_SPITOOL=y
CONFIG_ADAFRUIT_FRUIT_JAM_RP2350_ESP_HOSTED=y
CONFIG_ADAFRUIT_FRUIT_JAM_RP2350_ESP_HOSTED_AUTOSTART=y
CONFIG_ADAFRUIT_FRUIT_JAM_RP2350_ESP_HOSTED_START_DELAY_MS=2500
CONFIG_DRIVERS_WIRELESS=y
CONFIG_ESP_HOSTED=y
CONFIG_ESP_HOSTED_HPWORK=y
CONFIG_ESP_HOSTED_SPI_FREQUENCY=10000000
CONFIG_ESP_HOSTED_RX_WORK_DRAIN_LIMIT=4
CONFIG_ESP_HOSTED_RX_POLL_DELAY_MS=10
CONFIG_ESP_HOSTED_RX_IDLE_POLL_DELAY_MS=20
CONFIG_SYSTEM_ESPHOSTEDCTL=y

CONFIG_NET=y
CONFIG_NET_IPv4=y
CONFIG_NET_ETH_PKTSIZE=1514
CONFIG_NETDEV_LATEINIT=y
CONFIG_NETDEV_WIRELESS_IOCTL=y
CONFIG_NET_BROADCAST=y
CONFIG_NET_PREALLOC_DEVIF_CALLBACKS=32
CONFIG_NET_ALLOC_DEVIF_CALLBACKS=16
CONFIG_NET_TCP=y
CONFIG_NET_TCP_PREALLOC_CONNS=32
CONFIG_NET_TCP_ALLOC_CONNS=8
CONFIG_NET_TCP_MAX_CONNS=64
CONFIG_NET_TCP_NPOLLWAITERS=24
CONFIG_NET_TCPBACKLOG_CONNS=32
CONFIG_NET_TCP_WAIT_TIMEOUT=2
CONFIG_NET_TCP_WRITE_BUFFERS=y
CONFIG_NET_SEND_BUFSIZE=8192
CONFIG_NET_MAX_SEND_BUFSIZE=16384
CONFIG_NET_RECV_BUFSIZE=8192
CONFIG_NET_MAX_RECV_BUFSIZE=16384
CONFIG_NET_TCP_NWRBCHAINS=32
CONFIG_NET_TCP_ALLOC_WRBCHAINS=8
CONFIG_NET_UDP=y
CONFIG_NET_ICMP_SOCKET=y
CONFIG_NETDB_DNSCLIENT=y
CONFIG_NET_ARP_SEND_QUEUE=y
CONFIG_ARP_SEND_MAXTRIES=10
CONFIG_ARP_SEND_DELAYMSEC=100
CONFIG_IOB_NBUFFERS=512
CONFIG_IOB_BUFSIZE=256
CONFIG_IOB_NCHAINS=128

CONFIG_NETUTILS_DHCPC=y
CONFIG_NETUTILS_FTPC=y
CONFIG_NETUTILS_FTPD=y
CONFIG_NETUTILS_NETCAT=y
CONFIG_NETUTILS_NTPCLIENT=y
CONFIG_NETUTILS_TELNETD=y
CONFIG_TELNET_SEND_TIMEOUT_MS=5000
CONFIG_NETUTILS_WEBCLIENT=y
CONFIG_NETUTILS_WEBSERVER=y
# CONFIG_NETUTILS_HTTPD_SINGLECONNECT is not set
# CONFIG_NETUTILS_HTTPD_ENABLE_CHUNKED_ENCODING is not set
CONFIG_NETUTILS_HTTPD_TIMEOUT=3
CONFIG_NETUTILS_HTTPD_SENDFILE=y
CONFIG_NETUTILS_HTTPD_PATH="/mnt/sd0/www"
CONFIG_NETUTILS_HTTPD_INDEX="index.html"
CONFIG_NETUTILS_HTTPD_DIRLIST=y
CONFIG_NETUTILS_NETCAT_BUFSIZE=1460
CONFIG_FTPD_CMDBUFFERSIZE=512
CONFIG_FTPD_DATABUFFERSIZE=4096
CONFIG_FTPD_CONTROL_TIMEOUT_MS=300000
CONFIG_FTPD_DATA_TIMEOUT_MS=15000
CONFIG_FTPD_PASV_TIMEOUT_MS=10000
CONFIG_EXAMPLES_FTPD_ROOT="/mnt/sd0/www"
# CONFIG_NETUTILS_MQTTC is not set
CONFIG_EXAMPLES_FTPC=y
CONFIG_EXAMPLES_FTPD=y
CONFIG_EXAMPLES_WEBSERVER=y
# CONFIG_EXAMPLES_MQTTC is not set
CONFIG_SYSTEM_DHCPC_RENEW=y
CONFIG_SYSTEM_NTPC=y
CONFIG_SYSTEM_PING=y
CONFIG_SYSTEM_TELNETD=y
CONFIG_SYSTEM_TELNET_CLIENT=y
CONFIG_WIRELESS_WAPI=y
CONFIG_WIRELESS_WAPI_CMDTOOL=y

CONFIG_WATCHDOG=y
CONFIG_SYSTEM_RP2350WATCHDOG=y
CONFIG_SYSTEM_RP2350WATCHDOG_PRIORITY=110
CONFIG_SYSTEM_RP2350WATCHDOG_TIMEOUT_MS=15000
CONFIG_SYSTEM_RP2350WATCHDOG_PING_MS=5000
# CONFIG_SYSTEM_RP2350WATCHDOG_BOOTSEL_RECOVERY is not set
CONFIG_SYSTEM_RP2350WATCHDOG_DEV_BOOTSEL_MS=0
# CONFIG_ADAFRUIT_FRUIT_JAM_RP2350_BOOT_GUARD is not set
# CONFIG_SYSTEM_BOOTGUARD is not set

# CONFIG_RP23XX_PSRAM is not set
# CONFIG_RP23XX_HSTX_DVI is not set
# CONFIG_AUDIO is not set
# CONFIG_USBHOST is not set
```

## profiles/fruit-jam-trmnl/defconfig
```kconfig
# NuttX RP2350: Adafruit Fruit Jam TRMNL client release profile
# Preserves the working 800x480 Y2/PSRAM/ESP-Hosted client configuration.

CONFIG_ALLOW_BSD_COMPONENTS=y
CONFIG_ARCH="arm"
CONFIG_ARCH_BOARD="adafruit-fruit-jam-rp2350"
CONFIG_ARCH_BOARD_ADAFRUIT_FRUIT_JAM_RP2350=y
CONFIG_ARCH_BOARD_COMMON=y
CONFIG_ARCH_CHIP="rp23xx"
CONFIG_ARCH_CHIP_RP23XX=y
CONFIG_ARCH_INTERRUPTSTACK=2048
CONFIG_ARCH_RAMVECTORS=y
CONFIG_ARCH_SETJMP_H=y
CONFIG_ARCH_STACKDUMP=y
CONFIG_ARCH_TOOLCHAIN_GCC=y
CONFIG_ARCH_TOOLCHAIN_GNU=y
CONFIG_ARM_TOOLCHAIN_GNU_EABI=y
CONFIG_BOARD_LOOPSPERMSEC=10450
CONFIG_BOARDCTL_RESET=y
CONFIG_BOARD_LATE_INITIALIZE=y
CONFIG_BUILTIN=y
CONFIG_DEFAULT_TASK_STACKSIZE=4096
CONFIG_RR_INTERVAL=10
CONFIG_IDLETHREAD_STACKSIZE=2048
CONFIG_INIT_ENTRYPOINT="nsh_main"
CONFIG_INIT_STACKSIZE=4096
CONFIG_RAM_START=0x20000000
CONFIG_RAM_SIZE=532480
CONFIG_RP23XX_RP2350B=y
# CONFIG_RP23XX_UART0 is not set
# CONFIG_DEV_CONSOLE is not set

CONFIG_USBDEV=y
CONFIG_USBDEV_BUSPOWERED=y
CONFIG_CDCACM=y
CONFIG_CDCACM_CONSOLE=y
CONFIG_CDCACM_BOOTSEL_TOUCH=y
CONFIG_CDCACM_BOOTSEL_TOUCH_RESET_STATUS=3
CONFIG_SERIAL_TERMIOS=y
CONFIG_TTY_SIGINT=y
CONFIG_TTY_SIGINT_CHAR=0x03
CONFIG_SCHED_HPWORK=y
CONFIG_SCHED_LPWORK=y
CONFIG_SCHED_LPWORKPRIORITY=80
CONFIG_SCHED_WAITPID=y
CONFIG_SIG_DEFAULT=y

CONFIG_ETC_ROMFS=y
CONFIG_ETC_ROMFSDEVNO=1
CONFIG_FS_ROMFS=y
CONFIG_FS_FAT=y
CONFIG_FS_FATTIME=y
CONFIG_FAT_LFN=y
CONFIG_FS_PROCFS=y
CONFIG_FS_PROCFS_REGISTER=y
CONFIG_FS_TMPFS=y
CONFIG_MMCSD=y
CONFIG_MMCSD_PROCFS=y
CONFIG_LIBC_NETDB=y
CONFIG_LIBC_PERROR_STDOUT=y
CONFIG_LIBC_STRERROR=y
CONFIG_LIB_ZLIB=y
CONFIG_CRYPTO_MBEDTLS=y
CONFIG_DEV_URANDOM=y
CONFIG_NFILE_DESCRIPTORS_PER_BLOCK=16
CONFIG_LINE_MAX=256
CONFIG_MM_KERNEL_HEAP=y
CONFIG_MM_KERNEL_HEAPSIZE=131072

CONFIG_NSH_BUILTIN_APPS=y
CONFIG_NSH_FILEIOSIZE=512
CONFIG_NSH_READLINE=y
CONFIG_NSH_ROMFSRC=y
CONFIG_NSH_STRERROR=y
CONFIG_NSH_USBCONSOLE=y
CONFIG_NSH_USBCONSOLE_CONNECT_DELAY=500
CONFIG_NSH_USBCONSOLE_WAIT_DTR=y
CONFIG_NSH_USBCONSOLE_WAIT_DTR_TIMEOUT=30000
# CONFIG_NSH_USBCONSOLE_WAIT_INPUT is not set
CONFIG_READLINE_TABCOMPLETION=y
CONFIG_READLINE_CMD_HISTORY=y
CONFIG_READLINE_CMD_HISTORY_LINELEN=128
CONFIG_READLINE_CMD_HISTORY_LEN=16
CONFIG_SYSTEM_NSH=y
CONFIG_SYSTEM_NSH_STACKSIZE=4096
CONFIG_SYSTEM_SYSTEM=y
CONFIG_SYSTEM_BOOTSEL=y

CONFIG_RP23XX_SPI=y
CONFIG_RP23XX_SPI0=y
CONFIG_RP23XX_SPI1=y
CONFIG_ADAFRUIT_FRUIT_JAM_SD_SPI=y
CONFIG_RP23XX_SPISD=y
CONFIG_RP23XX_SDCARD_AUTOMOUNT=y
CONFIG_RP23XX_PSRAM=y
CONFIG_RP23XX_PSRAM_CS1_GPIO=47
CONFIG_RP23XX_PSRAM_HEAP_USER=y
CONFIG_RP23XX_PSRAM_SIZE=8388608
CONFIG_RP23XX_PSRAM_WAIT_TIMEOUT=1000000
CONFIG_DRIVERS_VIDEO=y
CONFIG_VIDEO_FB=y
CONFIG_FB_UPDATE=y
CONFIG_RP23XX_HSTX_DVI=y
CONFIG_RP23XX_HSTX_DVI_BOOT_AUTOSTART=y
CONFIG_RP23XX_HSTX_DVI_FB_Y2_800X480=y
CONFIG_RP23XX_HSTX_DVI_PIXEL_CLOCK=25200000
CONFIG_RP23XX_HSTX_DVI_SCANOUT_PSRAM=y
CONFIG_RP23XX_HSTX_DVI_SINGLE_SCANOUT_INTERNAL=y
CONFIG_RP23XX_HSTX_DVI_Y2_OUTPUT_NATIVE_800X480=y
CONFIG_SYSTEM_DVICTRL=y
# CONFIG_SYSTEM_DVICTRL_START_GUARD is not set

CONFIG_DRIVERS_WIRELESS=y
CONFIG_RP23XX_SPI1_RX_GPIO=28
CONFIG_RP23XX_SPI1_CS_GPIO=46
CONFIG_RP23XX_SPI1_SCK_GPIO=30
CONFIG_RP23XX_SPI1_TX_GPIO=31
CONFIG_ADAFRUIT_FRUIT_JAM_RP2350_ESP_HOSTED=y
# CONFIG_ADAFRUIT_FRUIT_JAM_RP2350_ESP_HOSTED_AUTOSTART is not set
CONFIG_ESP_HOSTED=y
CONFIG_ESP_HOSTED_LPWORK=y
CONFIG_NET=y
CONFIG_NET_IPv4=y
CONFIG_NETDEV_LATEINIT=y
CONFIG_NET_BROADCAST=y
CONFIG_NET_TCP=y
CONFIG_NET_TCP_PREALLOC_CONNS=16
CONFIG_NET_TCP_ALLOC_CONNS=8
CONFIG_NET_TCP_MAX_CONNS=32
CONFIG_NET_TCP_NPOLLWAITERS=8
CONFIG_NET_TCPBACKLOG_CONNS=16
CONFIG_NET_TCP_WAIT_TIMEOUT=2
CONFIG_NET_TCP_WRITE_BUFFERS=y
CONFIG_NET_SEND_BUFSIZE=8192
CONFIG_NET_MAX_SEND_BUFSIZE=16384
CONFIG_NET_RECV_BUFSIZE=8192
CONFIG_NET_MAX_RECV_BUFSIZE=16384
CONFIG_NET_TCP_NWRBCHAINS=16
CONFIG_NET_TCP_ALLOC_WRBCHAINS=8
CONFIG_NET_UDP=y
CONFIG_NETDB_DNSCLIENT=y
CONFIG_NETUTILS_DHCPC=y
CONFIG_NETUTILS_CJSON=y
CONFIG_NETUTILS_WEBCLIENT=y
CONFIG_WEBCLIENT_MAXFILENAME=2048
CONFIG_WEBCLIENT_MAXHTTPLINE=4096
CONFIG_IOB_NBUFFERS=96
CONFIG_IOB_NCHAINS=96
CONFIG_WIRELESS_WAPI=y
CONFIG_WIRELESS_WAPI_CMDTOOL=y
CONFIG_SYSTEM_DHCPC_RENEW=y

CONFIG_SYSTEM_TRMNL=y
CONFIG_SYSTEM_TRMNL_BOOT_AUTOSTART=y
CONFIG_SYSTEM_TRMNL_BOOT_WIFI_RETRIES=8
CONFIG_SYSTEM_TRMNL_BOOT_WIFI_RETRY_DELAY=2
CONFIG_SYSTEM_TRMNL_FLASH_DATA_DIR="/flash/trmnl"
CONFIG_SYSTEM_TRMNL_SD_DATA_DIR=""
CONFIG_SYSTEM_TRMNL_STACKSIZE=49152
CONFIG_SYSTEM_TRMNL_TLS_ALLOW_UNVERIFIED=y
CONFIG_SYSTEM_TRMNL_TLS_CA_CERT_PATH=""
CONFIG_SYSTEM_TRMNL_WIFI_AUTOSTART=y
CONFIG_SYSTEM_TRMNL_WIFI_CONFIG_PATH=""

CONFIG_WATCHDOG=y
CONFIG_SYSTEM_RP2350WATCHDOG=y
CONFIG_SYSTEM_RP2350WATCHDOG_PRIORITY=110
CONFIG_SYSTEM_RP2350WATCHDOG_TIMEOUT_MS=15000
CONFIG_SYSTEM_RP2350WATCHDOG_PING_MS=5000
# CONFIG_SYSTEM_RP2350WATCHDOG_BOOTSEL_RECOVERY is not set
CONFIG_SYSTEM_RP2350WATCHDOG_DEV_BOOTSEL_MS=0
# CONFIG_ADAFRUIT_FRUIT_JAM_RP2350_BOOT_GUARD is not set
# CONFIG_SYSTEM_BOOTGUARD is not set
```

## profiles/pico-2-w-minimal/defconfig
```kconfig
# NuttX RP2350: Raspberry Pi Pico 2 W minimal release profile
# USB CDC NSH + Berry + vi + readline/history + I2C + watchdog.

CONFIG_ALLOW_BSD_COMPONENTS=y
CONFIG_ARCH="arm"
CONFIG_ARCH_BOARD="raspberrypi-pico-2-w"
CONFIG_ARCH_BOARD_RASPBERRYPI_PICO_2_W=y
CONFIG_ARCH_BOARD_COMMON=y
CONFIG_ARCH_CHIP="rp23xx"
CONFIG_ARCH_CHIP_RP23XX=y
CONFIG_ARCH_INTERRUPTSTACK=2048
CONFIG_ARCH_RAMVECTORS=y
CONFIG_ARCH_SETJMP_H=y
CONFIG_ARCH_STACKDUMP=y
CONFIG_ARCH_TOOLCHAIN_GCC=y
CONFIG_ARCH_TOOLCHAIN_GNU=y
CONFIG_ARM_TOOLCHAIN_GNU_EABI=y
CONFIG_BOARD_LOOPSPERMSEC=10450
CONFIG_BOARDCTL_RESET=y
CONFIG_BUILTIN=y
CONFIG_DEFAULT_TASK_STACKSIZE=4096
CONFIG_IDLETHREAD_STACKSIZE=2048
CONFIG_INIT_ENTRYPOINT="nsh_main"
CONFIG_INIT_STACKSIZE=4096
CONFIG_PTHREAD_STACK_DEFAULT=4096
CONFIG_RAM_START=0x20000000
CONFIG_RAM_SIZE=532480
# CONFIG_RP23XX_UART0 is not set
# CONFIG_DEV_CONSOLE is not set

CONFIG_USBDEV=y
CONFIG_USBDEV_BUSPOWERED=y
CONFIG_CDCACM=y
CONFIG_CDCACM_CONSOLE=y
CONFIG_CDCACM_BOOTSEL_TOUCH=y
CONFIG_CDCACM_BOOTSEL_TOUCH_RESET_STATUS=3
CONFIG_SERIAL_TERMIOS=y
CONFIG_TTY_SIGINT=y
CONFIG_TTY_SIGINT_CHAR=0x03
CONFIG_SCHED_HPWORK=y
CONFIG_SCHED_WAITPID=y
CONFIG_SIG_DEFAULT=y
CONFIG_RR_INTERVAL=200

CONFIG_FS_PROCFS=y
CONFIG_FS_PROCFS_REGISTER=y
CONFIG_FS_TMPFS=y
CONFIG_FS_ROMFS=y
CONFIG_ETC_ROMFS=y
CONFIG_LIBC_PERROR_STDOUT=y
CONFIG_LIBC_STRERROR=y
CONFIG_NFILE_DESCRIPTORS_PER_BLOCK=6
CONFIG_LINE_MAX=256

CONFIG_NSH_ARCHINIT=y
CONFIG_NSH_BUILTIN_APPS=y
CONFIG_NSH_FILEIOSIZE=512
CONFIG_NSH_READLINE=y
CONFIG_NSH_STRERROR=y
CONFIG_NSH_USBCONSOLE=y
CONFIG_NSH_USBCONSOLE_CONNECT_DELAY=500
CONFIG_NSH_USBCONSOLE_WAIT_DTR=y
CONFIG_NSH_USBCONSOLE_WAIT_DTR_TIMEOUT=5000
# CONFIG_NSH_USBCONSOLE_WAIT_INPUT is not set
CONFIG_READLINE_TABCOMPLETION=y
CONFIG_READLINE_CMD_HISTORY=y
CONFIG_READLINE_CMD_HISTORY_LINELEN=256
CONFIG_READLINE_CMD_HISTORY_LEN=32

CONFIG_INTERPRETERS_BERRY=y
CONFIG_INTERPRETERS_BERRY_STACKSIZE=8192
CONFIG_SYSTEM_NSH=y
CONFIG_SYSTEM_NSH_STACKSIZE=4096
CONFIG_SYSTEM_VI=y
CONFIG_SYSTEM_VI_COLS=80
CONFIG_SYSTEM_VI_ROWS=24
CONFIG_SYSTEM_VI_STACKSIZE=4096
CONFIG_SYSTEM_I2CTOOL=y
CONFIG_SYSTEM_DUMPSTACK=y
CONFIG_SYSTEM_SYSTEM=y
CONFIG_SYSTEM_BOOTSEL=y

CONFIG_RP23XX_I2C=y
CONFIG_RP23XX_I2C0=y
CONFIG_RP23XX_I2C0_SDA_GPIO=4
CONFIG_RP23XX_I2C0_SCL_GPIO=5
CONFIG_RP23XX_I2C_DRIVER=y

CONFIG_WATCHDOG=y
CONFIG_SYSTEM_RP2350WATCHDOG=y
CONFIG_SYSTEM_RP2350WATCHDOG_PRIORITY=110
CONFIG_SYSTEM_RP2350WATCHDOG_TIMEOUT_MS=15000
CONFIG_SYSTEM_RP2350WATCHDOG_PING_MS=5000
# CONFIG_SYSTEM_RP2350WATCHDOG_BOOTSEL_RECOVERY is not set
CONFIG_SYSTEM_RP2350WATCHDOG_DEV_BOOTSEL_MS=0
# CONFIG_RP23XX_AUTO_BOOTSEL_ON_BOOT is not set

# CONFIG_NET is not set
# CONFIG_RP23XX_INFINEON_CYW43439 is not set
# CONFIG_RP23XX_PSRAM is not set
# CONFIG_RP23XX_SPISD is not set
# CONFIG_RP23XX_HSTX_DVI is not set
# CONFIG_AUDIO is not set
# CONFIG_USBHOST is not set
```
