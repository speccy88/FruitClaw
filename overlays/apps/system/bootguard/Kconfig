## profiles/fruit-jam-full/defconfig
```kconfig
# NuttX RP2350: Adafruit Fruit Jam full hardware/network release profile
# FruitClaw is intentionally absent; see fruit-jam-full-fruitclaw.

CONFIG_ALLOW_BSD_COMPONENTS=y
CONFIG_ARCH="arm"
CONFIG_ARCH_BOARD="adafruit-fruit-jam-rp2350"
CONFIG_ARCH_BOARD_ADAFRUIT_FRUIT_JAM_RP2350=y
CONFIG_ARCH_BOARD_COMMON=y
CONFIG_ARCH_BUTTONS=y
CONFIG_ARCH_IRQBUTTONS=y
CONFIG_ARCH_CHIP="rp23xx"
CONFIG_ARCH_CHIP_RP23XX=y
CONFIG_ARCH_INTERRUPTSTACK=2048
CONFIG_ARCH_RAMVECTORS=y
CONFIG_ARCH_SETJMP_H=y
CONFIG_ARCH_STACKDUMP=y
CONFIG_ARCH_TOOLCHAIN_GCC=y
CONFIG_ARCH_TOOLCHAIN_GNU=y
CONFIG_ARM_TOOLCHAIN_GNU_EABI=y
CONFIG_BOARD_LOOPSPERMSEC=10450
CONFIG_BOARDCTL_RESET=y
CONFIG_BUILTIN=y
CONFIG_DEFAULT_TASK_STACKSIZE=4096
CONFIG_RR_INTERVAL=10
CONFIG_IDLETHREAD_STACKSIZE=2048
CONFIG_INIT_ENTRYPOINT="nsh_main"
CONFIG_INIT_STACKSIZE=8192
CONFIG_PTHREAD_STACK_DEFAULT=4096
CONFIG_RAM_START=0x20000000
CONFIG_RAM_SIZE=532480
CONFIG_RP23XX_RP2350B=y
# CONFIG_RP23XX_UART0 is not set
# CONFIG_ARCH_LEDS is not set
# CONFIG_DEV_CONSOLE is not set

CONFIG_USBDEV=y
CONFIG_USBDEV_BUSPOWERED=y
CONFIG_CDCACM=y
CONFIG_CDCACM_CONSOLE=y
CONFIG_CDCACM_BOOTSEL_TOUCH=y
CONFIG_CDCACM_BOOTSEL_TOUCH_RESET_STATUS=3
CONFIG_CDCACM_BULKIN_REQLEN=96
CONFIG_CDCACM_BULKOUT_REQLEN=256
CONFIG_CDCACM_NRDREQS=4
CONFIG_CDCACM_NWRREQS=4
CONFIG_CDCACM_RXBUFSIZE=1025
CONFIG_CDCACM_TXBUFSIZE=513
CONFIG_SERIAL_TERMIOS=y
CONFIG_TTY_SIGINT=y
CONFIG_TTY_SIGINT_CHAR=0x03
CONFIG_SCHED_HPWORK=y
CONFIG_SCHED_LPWORK=y
CONFIG_SCHED_LPWORKPRIORITY=80
CONFIG_SCHED_WAITPID=y
CONFIG_SIG_DEFAULT=y

CONFIG_ETC_ROMFS=y
CONFIG_ETC_ROMFSDEVNO=1
CONFIG_FS_ROMFS=y
CONFIG_FS_FAT=y
CONFIG_FS_FATTIME=y
CONFIG_FAT_LFN=y
CONFIG_FAT_LCNAMES=y
CONFIG_FS_PROCFS=y
CONFIG_FS_PROCFS_REGISTER=y
CONFIG_FS_TMPFS=y
CONFIG_FSUTILS_MKFATFS=y
CONFIG_MBR_PARTITION=y
CONFIG_MMCSD=y
CONFIG_MMCSD_PROCFS=y
CONFIG_MMCSD_IDMODE_CLOCK=200000
CONFIG_MMCSD_MULTIBLOCK_LIMIT=1
CONFIG_LIBC_FLOATINGPOINT=y
CONFIG_LIBC_PERROR_STDOUT=y
CONFIG_LIBC_STRERROR=y
CONFIG_NFILE_DESCRIPTORS_PER_BLOCK=16
CONFIG_LINE_MAX=1024
CONFIG_MM_KERNEL_HEAP=y
CONFIG_MM_KERNEL_HEAPSIZE=65536

CONFIG_NSH_BUILTIN_APPS=y
CONFIG_NSH_FILEIOSIZE=512
CONFIG_NSH_READLINE=y
CONFIG_NSH_ROMFSRC=y
CONFIG_NSH_STRERROR=y
CONFIG_NSH_USBCONSOLE=y
CONFIG_NSH_USBCONSOLE_CONNECT_DELAY=500
CONFIG_NSH_USBCONSOLE_WAIT_DTR=y
# CONFIG_NSH_USBCONSOLE_WAIT_INPUT is not set
# CONFIG_NSH_DISABLE_IFCONFIG is not set
# CONFIG_NSH_DISABLE_WGET is not set
CONFIG_READLINE_TABCOMPLETION=y
CONFIG_READLINE_CMD_HISTORY=y
CONFIG_READLINE_CMD_HISTORY_LINELEN=1024
CONFIG_READLINE_CMD_HISTORY_LEN=16
CONFIG_READLINE_FORCE_ECHO=y
CONFIG_INTERPRETERS_BERRY=y
CONFIG_INTERPRETERS_BERRY_STACKSIZE=32768
CONFIG_SYSTEM_NSH=y
CONFIG_SYSTEM_NSH_STACKSIZE=8192
CONFIG_SYSTEM_VI=y
CONFIG_SYSTEM_VI_COLS=80
CONFIG_SYSTEM_VI_ROWS=24
CONFIG_SYSTEM_VI_STACKSIZE=4096
CONFIG_SYSTEM_DUMPSTACK=y
CONFIG_SYSTEM_SYSTEM=y
CONFIG_SYSTEM_BOOTSEL=y

CONFIG_INPUT=y
CONFIG_INPUT_BUTTONS=y
CONFIG_INPUT_BUTTONS_LOWER=y
CONFIG_INPUT_KEYBOARD=y
CONFIG_INPUT_MOUSE=y
CONFIG_INPUT_MOUSE_WHEEL=y
CONFIG_EXAMPLES_BUTTONS=y
CONFIG_EXAMPLES_BUTTONS_NAME0="BUTTON1"
CONFIG_EXAMPLES_BUTTONS_NAME1="BUTTON2"
CONFIG_EXAMPLES_BUTTONS_NAME2="BUTTON3"
CONFIG_EXAMPLES_BUTTONS_NAMES=y
CONFIG_EXAMPLES_BUTTONS_QTD=3
CONFIG_SYSTEM_BUTTONCTL=y

CONFIG_RP23XX_I2C=y
CONFIG_RP23XX_I2C0=y
CONFIG_RP23XX_I2C0_SDA_GPIO=20
CONFIG_RP23XX_I2C0_SCL_GPIO=21
CONFIG_RP23XX_I2C_DRIVER=y
CONFIG_SYSTEM_I2CTOOL=y
CONFIG_RP23XX_SPI=y
CONFIG_RP23XX_SPI0=y
CONFIG_RP23XX_SPI0_RX_GPIO=36
CONFIG_RP23XX_SPI0_CS_GPIO=39
CONFIG_RP23XX_SPI0_SCK_GPIO=34
CONFIG_RP23XX_SPI0_TX_GPIO=35
CONFIG_RP23XX_SPI1=y
CONFIG_RP23XX_SPI1_RX_GPIO=28
CONFIG_RP23XX_SPI1_CS_GPIO=46
CONFIG_RP23XX_SPI1_SCK_GPIO=30
CONFIG_RP23XX_SPI1_TX_GPIO=31
CONFIG_ADAFRUIT_FRUIT_JAM_SD_SPI=y
CONFIG_RP23XX_SPISD=y
CONFIG_RP23XX_SPISD_AUTOMOUNT=y
CONFIG_RP23XX_SDCARD_AUTOMOUNT=y
CONFIG_MMCSD_SPICLOCK=4000000
CONFIG_MMCSD_SPIRETRY_COUNT=3
CONFIG_SYSTEM_SDMOUNT=y
CONFIG_SYSTEM_SPITOOL=y

CONFIG_RP23XX_PSRAM=y
CONFIG_RP23XX_PSRAM_CS1_GPIO=47
CONFIG_RP23XX_PSRAM_HEAP_USER=y
CONFIG_RP23XX_PSRAM_SIZE=8388608
CONFIG_RP23XX_PSRAM_WAIT_TIMEOUT=1000000
CONFIG_DRIVERS_VIDEO=y
CONFIG_VIDEO_FB=y
CONFIG_FB_UPDATE=y
CONFIG_RP23XX_HSTX_DVI=y
CONFIG_RP23XX_HSTX_DVI_BOOT_AUTOSTART=y
CONFIG_RP23XX_HSTX_DVI_FB_RGB565_320X240=y
CONFIG_RP23XX_HSTX_DVI_OUTPUT_SCALING=1
CONFIG_RP23XX_HSTX_DVI_PIXEL_CLOCK=25200000
CONFIG_RP23XX_HSTX_DVI_SCANOUT_PSRAM=y
CONFIG_RP23XX_HSTX_DVI_SINGLE_SCANOUT_INTERNAL=y
CONFIG_SYSTEM_DVICTRL=y
# CONFIG_SYSTEM_DVICTRL_START_GUARD is not set
CONFIG_EXAMPLES_FB=y

CONFIG_AUDIO=y
CONFIG_AUDIO_FORMAT_PCM=y
CONFIG_AUDIO_FORMAT_RAW=y
CONFIG_AUDIO_I2S=y
CONFIG_AUDIO_I2SCHAR=y
CONFIG_DRIVERS_AUDIO=y
CONFIG_RP23XX_I2S=y
CONFIG_RP23XX_I2S_CLOCK=26
CONFIG_RP23XX_I2S_DATA=24
CONFIG_RP23XX_I2S_PIO=1
CONFIG_AUDIOUTILS_RTTTL_C=y
CONFIG_SYSTEM_NXPLAYER=y
CONFIG_SYSTEM_RTTTL=y
CONFIG_SYSTEM_RTTTL_SAMPLERATE=44100
CONFIG_SYSTEM_RTTTL_VOLUME=85

CONFIG_RP23XX_BOARD_HAS_WS2812=y
CONFIG_RP23XX_WS2812_GPIO_PIN=32
CONFIG_WS2812=y
CONFIG_WS2812_LED_COUNT=5
CONFIG_WS2812_FREQUENCY=800000
CONFIG_SYSTEM_NEOPIXELS=y
CONFIG_EXAMPLES_WS2812=y
CONFIG_DRIVERS_RC=y
CONFIG_ADAFRUIT_FRUIT_JAM_RP2350_IR_RX=y
CONFIG_SYSTEM_IRDUMP=y

CONFIG_USBHOST=y
CONFIG_USBHOST_HAVE_ASYNCH=y
CONFIG_USBHOST_ASYNCH=y
CONFIG_USBHOST_WAITER=y
CONFIG_USBHOST_WAITER_PRIO=100
CONFIG_USBHOST_WAITER_STACKSIZE=4096
CONFIG_USBHOST_HUB=y
CONFIG_USBHOST_COMPOSITE=y
CONFIG_USBHOST_HID=y
CONFIG_USBHOST_HIDKBD=y
CONFIG_USBHOST_HIDMOUSE=y
CONFIG_USBHOST_XBOXCONTROLLER=y
CONFIG_HIDKBD_INPUT=y
CONFIG_HIDKBD_INPUT_DEVPATH="/dev/kbd0"
CONFIG_HIDKBD_INPUT_DOSKEYS=y
CONFIG_HIDKBD_NOGETREPORT=y
CONFIG_RP23XX_PIO_USBHOST=y
CONFIG_RP23XX_PIO_USBHOST_DP_GPIO=1
CONFIG_RP23XX_PIO_USBHOST_DM_GPIO=2
CONFIG_RP23XX_PIO_USBHOST_VBUS_GPIO=11
CONFIG_RP23XX_PIO_USBHOST_PIO=0
CONFIG_RP23XX_PIO_USBHOST_TX_SM=0
CONFIG_RP23XX_PIO_USBHOST_RX_SM=1
CONFIG_RP23XX_PIO_USBHOST_EOP_SM=2
CONFIG_RP23XX_PIO_USBHOST_DMA_CHANNEL=9
CONFIG_RP23XX_PIO_USBHOST_FRAME_IRQ=y
CONFIG_RP23XX_PIO_USBHOST_ENUM_DELAY_MS=1000
CONFIG_RP23XX_PIO_USBHOST_RESET_MS=100
CONFIG_RP23XX_PIO_USBHOST_POST_RESET_MS=250
CONFIG_RP23XX_PIO_USBHOST_SETADDR_DELAY_MS=1000
CONFIG_RP23XX_PIO_USBHOST_ENUM_ATTEMPTS=4
CONFIG_RP23XX_PIO_USBHOST_CTRL_GAP_MS=50
CONFIG_RP23XX_PIO_USBHOST_CTRL_RETRIES=8
CONFIG_SYSTEM_PIOUSBHOST=y
CONFIG_SYSTEM_PIOUSBHOST_EXPECT_KEYBOARDS=2
CONFIG_SYSTEM_PIOUSBHOST_EXPECT_MICE=2
CONFIG_SYSTEM_PIOUSBHOST_HID_WAIT_SEC=50
CONFIG_SYSTEM_PIOUSBHOST_HUB_SETTLE_SEC=24
CONFIG_EXAMPLES_HIDKBD=y
CONFIG_EXAMPLES_KEYBOARD=y
CONFIG_EXAMPLES_TOUCHSCREEN=y
CONFIG_EXAMPLES_TOUCHSCREEN_DEVPATH="/dev/mouse0"
CONFIG_EXAMPLES_TOUCHSCREEN_MOUSE=y
CONFIG_EXAMPLES_XBC_TEST=y

CONFIG_GRAPHICS_LVGL=y
CONFIG_LVGL_VERSION_MAJOR=9
CONFIG_LVGL_VERSION_MINOR=2
CONFIG_LVGL_VERSION_PATCH=2
CONFIG_LV_COLOR_DEPTH_16=y
CONFIG_LV_DPI_DEF=128
CONFIG_LV_CONF_SKIP=y
CONFIG_LV_USE_CLIB_MALLOC=y
CONFIG_LV_USE_CLIB_SPRINTF=y
CONFIG_LV_USE_CLIB_STRING=y
CONFIG_LV_USE_NUTTX=y
CONFIG_INTERPRETERS_BERRY_LVGL=y
CONFIG_INTERPRETERS_BERRY_LVGL_GLOBAL=y
CONFIG_INTERPRETERS_BERRY_LVGL_MOUSE=y
CONFIG_INTERPRETERS_BERRY_LVGL_MOUSE_DEVPATH="/dev/mouse0"

CONFIG_DRIVERS_WIRELESS=y
CONFIG_ADAFRUIT_FRUIT_JAM_RP2350_ESP_HOSTED=y
CONFIG_ADAFRUIT_FRUIT_JAM_RP2350_ESP_HOSTED_AUTOSTART=y
CONFIG_ADAFRUIT_FRUIT_JAM_RP2350_ESP_HOSTED_START_DELAY_MS=2500
CONFIG_ESP_HOSTED=y
CONFIG_ESP_HOSTED_HPWORK=y
CONFIG_SYSTEM_ESPHOSTEDCTL=y
CONFIG_NET=y
CONFIG_NET_IPv4=y
CONFIG_NETDEV_LATEINIT=y
CONFIG_NETDEV_WIRELESS_IOCTL=y
CONFIG_NET_BROADCAST=y
CONFIG_NET_TCP=y
CONFIG_NET_TCP_PREALLOC_CONNS=32
CONFIG_NET_TCP_ALLOC_CONNS=8
CONFIG_NET_TCP_MAX_CONNS=64
CONFIG_NET_TCP_NPOLLWAITERS=24
CONFIG_NET_TCPBACKLOG_CONNS=32
CONFIG_NET_TCP_WAIT_TIMEOUT=2
CONFIG_NET_TCP_NOTIFIER=y
CONFIG_NET_TCP_WRITE_BUFFERS=y
CONFIG_NET_SEND_BUFSIZE=8192
CONFIG_NET_MAX_SEND_BUFSIZE=16384
CONFIG_NET_RECV_BUFSIZE=8192
CONFIG_NET_MAX_RECV_BUFSIZE=16384
CONFIG_NET_TCP_NWRBCHAINS=32
CONFIG_NET_TCP_ALLOC_WRBCHAINS=16
CONFIG_NET_UDP=y
CONFIG_NET_ICMP_SOCKET=y
CONFIG_NETDB_DNSCLIENT=y
CONFIG_NETDB_DNSCLIENT_ENTRIES=4
CONFIG_IOB_NBUFFERS=512
CONFIG_IOB_BUFSIZE=256
CONFIG_IOB_NCHAINS=128
CONFIG_NET_PREALLOC_DEVIF_CALLBACKS=32
CONFIG_NET_ALLOC_DEVIF_CALLBACKS=16
CONFIG_NETUTILS_DHCPC=y
CONFIG_NETUTILS_FTPC=y
CONFIG_NETUTILS_FTPD=y
CONFIG_FTPD_DATABUFFERSIZE=4096
CONFIG_NETUTILS_NETCAT=y
CONFIG_NETUTILS_NTPCLIENT=y
CONFIG_NETUTILS_TELNETD=y
CONFIG_TELNET_SEND_TIMEOUT_MS=5000
CONFIG_NETUTILS_WEBCLIENT=y
CONFIG_WEBCLIENT_MAXFILENAME=2048
CONFIG_WEBCLIENT_MAXHTTPLINE=4096
CONFIG_NETUTILS_WEBSERVER=y
CONFIG_NETUTILS_HTTPDSTACKSIZE=8192
CONFIG_NETUTILS_HTTPD_CLASSIC=y
CONFIG_NETUTILS_HTTPD_CGIPATH=y
CONFIG_NETUTILS_HTTPD_POST=y
CONFIG_NETUTILS_HTTPD_MAX_BODY=16384
# CONFIG_NETUTILS_HTTPD_SINGLECONNECT is not set
CONFIG_NETUTILS_HTTPD_TIMEOUT=10
CONFIG_NETUTILS_HTTPD_KEEPALIVE_DISABLE=y
# CONFIG_NETUTILS_MQTTC is not set
CONFIG_EXAMPLES_FTPC=y
CONFIG_EXAMPLES_FTPD=y
# Keep passwordless FTP on SD content, never at the filesystem root.
CONFIG_EXAMPLES_FTPD_ROOT="/mnt/sd0/www"
CONFIG_EXAMPLES_WEBSERVER=y
# CONFIG_EXAMPLES_MQTTC is not set
CONFIG_SYSTEM_DHCPC_RENEW=y
CONFIG_SYSTEM_NTPC=y
CONFIG_SYSTEM_PING=y
CONFIG_SYSTEM_TELNETD=y
CONFIG_SYSTEM_TELNETD_SESSION_STACKSIZE=8192
CONFIG_SYSTEM_TELNET_CLIENT=y
CONFIG_WIRELESS_WAPI=y
CONFIG_WIRELESS_WAPI_CMDTOOL=y

CONFIG_BENCHMARK_RAMSPEED=y
CONFIG_GAMES_CGOL=y
CONFIG_GAMES_CGOL_FRAMEDELAY=50000
CONFIG_GAMES_CGOL_MAPHEIGHT=240
CONFIG_GAMES_CGOL_MAPWIDTH=320
CONFIG_GAMES_CGOL_STACKSIZE=24576

CONFIG_WATCHDOG=y
CONFIG_SYSTEM_RP2350WATCHDOG=y
CONFIG_SYSTEM_RP2350WATCHDOG_PRIORITY=110
CONFIG_SYSTEM_RP2350WATCHDOG_TIMEOUT_MS=15000
CONFIG_SYSTEM_RP2350WATCHDOG_PING_MS=5000
# CONFIG_SYSTEM_RP2350WATCHDOG_BOOTSEL_RECOVERY is not set
CONFIG_SYSTEM_RP2350WATCHDOG_DEV_BOOTSEL_MS=0
# CONFIG_ADAFRUIT_FRUIT_JAM_RP2350_BOOT_GUARD is not set
# CONFIG_SYSTEM_BOOTGUARD is not set
# CONFIG_SYSTEM_DVICTRL_START_GUARD is not set
# CONFIG_SYSTEM_FRUITCLAW is not set
```
