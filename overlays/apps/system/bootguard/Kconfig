## overlays/apps/system/irdump/Kconfig
```kconfig
#
# For a description of the syntax of this configuration file,
# see the file kconfig-language.txt in the NuttX tools repository.
#

config SYSTEM_IRDUMP
	tristate "'irdump' command"
	default n
	depends on DRIVERS_RC
	---help---
		Enable a command that prints raw LIRC MODE2 pulse/space samples.

if SYSTEM_IRDUMP

config SYSTEM_IRDUMP_PROGNAME
	string "Program name"
	default "irdump"

config SYSTEM_IRDUMP_PRIORITY
	int "irdump task priority"
	default 100

config SYSTEM_IRDUMP_STACKSIZE
	int "irdump stack size"
	default DEFAULT_TASK_STACKSIZE

config SYSTEM_IRDUMP_DEVPATH
	string "LIRC device path"
	default "/dev/lirc0"

endif
```

## overlays/apps/system/neopixels/Kconfig
```kconfig
#
# For a description of the syntax of this configuration file,
# see the file kconfig-language.txt in the NuttX tools repository.
#

config SYSTEM_NEOPIXELS
	tristate "'neopixels' command"
	default n
	depends on WS2812
	---help---
		Enable a command that controls a WS2812/NeoPixel character
		device.

if SYSTEM_NEOPIXELS

config SYSTEM_NEOPIXELS_PROGNAME
	string "Program name"
	default "neopixels"

config SYSTEM_NEOPIXELS_PRIORITY
	int "neopixels task priority"
	default 100

config SYSTEM_NEOPIXELS_STACKSIZE
	int "neopixels stack size"
	default DEFAULT_TASK_STACKSIZE

config SYSTEM_NEOPIXELS_DEVPATH
	string "WS2812 device path"
	default "/dev/leds0"

endif
```

## overlays/apps/system/piousbhost/Kconfig
```kconfig
#
# For a description of the syntax of this configuration file,
# see the file kconfig-language.txt in the NuttX tools repository.
#

config SYSTEM_PIOUSBHOST
	tristate "'piousbhost' command"
	default n
	depends on RP23XX_PIO_USBHOST && USBHOST_WAITER
	---help---
		Enable a command that explicitly starts the RP23XX PIO USB host
		controller and the NuttX USB host waiter.

if SYSTEM_PIOUSBHOST

config SYSTEM_PIOUSBHOST_PROGNAME
	string "Program name"
	default "piousbhost"

config SYSTEM_PIOUSBHOST_PRIORITY
	int "piousbhost task priority"
	default 100

config SYSTEM_PIOUSBHOST_STACKSIZE
	int "piousbhost stack size"
	default DEFAULT_TASK_STACKSIZE

config SYSTEM_PIOUSBHOST_GUARD_REFRESH_MS
	int "Boot guard refresh interval milliseconds"
	default 2000
	range 250 30000
	depends on ADAFRUIT_FRUIT_JAM_RP2350_BOOT_GUARD
	---help---
		Interval used by piousbhost start-guarded to refresh the Fruit Jam
		boot guard while USB host startup is still in progress.

config SYSTEM_PIOUSBHOST_GUARD_WINDOW_MS
	int "Boot guard startup window milliseconds"
	default 60000
	range 1000 300000
	depends on ADAFRUIT_FRUIT_JAM_RP2350_BOOT_GUARD
	---help---
		Maximum time piousbhost start-guarded keeps refreshing the Fruit Jam
		boot guard before allowing the watchdog to recover the board.

config SYSTEM_PIOUSBHOST_EXPECT_KEYBOARDS
	int "Expected HID keyboards"
	default 0
	range 0 26
	---help---
		Number of raw HID keyboard nodes that piousbhost waits for during
		startup.  Leave this at zero for generic setups; set it for boards
		with a known attached keyboard configuration.

config SYSTEM_PIOUSBHOST_EXPECT_MICE
	int "Expected HID mice"
	default 0
	range 0 26
	---help---
		Number of HID mouse nodes that piousbhost waits for during startup.
		Leave this at zero for generic setups; set it for boards with a
		known attached mouse configuration.

config SYSTEM_PIOUSBHOST_HID_WAIT_SEC
	int "HID startup wait seconds"
	default 12
	range 0 300
	---help---
		Maximum time piousbhost waits for the configured expected HID
		keyboard and mouse nodes after hub startup scans.

config SYSTEM_PIOUSBHOST_HUB_SETTLE_SEC
	int "Hub startup settle seconds"
	default 16
	range 0 300
	---help---
		Maximum time piousbhost waits for connected downstream hub ports
		to become enabled after startup scans.  This gives receivers that
		need an extra reset pass time to enumerate before the command
		returns to NSH.

endif
```

## overlays/apps/system/rp2350watchdog/Kconfig
```kconfig
config SYSTEM_RP2350WATCHDOG
	tristate "RP2350 recovery watchdog daemon"
	default n
	depends on WATCHDOG && ARCH_CHIP_RP23XX
	---help---
		Feed the RP2350 hardware watchdog from a small background task.  A
		full scheduler or system hang stops the feed and performs a normal
		chip reset.  BOOTSEL conversion is a separate development-only option.

if SYSTEM_RP2350WATCHDOG

config SYSTEM_RP2350WATCHDOG_PROGNAME
	string "Program name"
	default "rp2350watchdog"

config SYSTEM_RP2350WATCHDOG_PRIORITY
	int "Task priority"
	default 90

config SYSTEM_RP2350WATCHDOG_STACKSIZE
	int "Task stack size"
	default 2048

config SYSTEM_RP2350WATCHDOG_DEVPATH
	string "Watchdog device path"
	default "/dev/watchdog0"

config SYSTEM_RP2350WATCHDOG_TIMEOUT_MS
	int "Hardware timeout in milliseconds"
	range 1000 16000
	default 15000
	---help---
		The RP23xx watchdog load register limits the hardware window to about
		16.7 seconds.  Keep this value at or below 16000 milliseconds.

config SYSTEM_RP2350WATCHDOG_PING_MS
	int "Keepalive period in milliseconds"
	range 100 15000
	default 5000

config SYSTEM_RP2350WATCHDOG_BOOTSEL_RECOVERY
	bool "Convert watchdog reset to BOOTSEL"
	default n
	depends on BOARDCTL && BOARDCTL_RESET
	---help---
		Development-only recovery switch.  Mark watchdog scratch registers so
		the board's early recovery path enters ROM BOOTSEL after a hang.
		Canonical release defconfigs must keep this disabled.

config SYSTEM_RP2350WATCHDOG_DEV_BOOTSEL_MS
	int "Development maximum uptime before BOOTSEL"
	range 0 3600000
	default 0
	depends on BOARDCTL && BOARDCTL_RESET
	---help---
		Development-only backstop.  Zero disables it.  Canonical release
		defconfigs require zero; --dev-bootsel overrides it to 600000.

endif
```

## overlays/apps/system/rtttl/Kconfig
```kconfig
#
# For a description of the syntax of this configuration file,
# see the file kconfig-language.txt in the NuttX tools repository.
#

config SYSTEM_RTTTL
	tristate "'rtttl' command"
	default n
	depends on AUDIO && AUDIO_FORMAT_PCM && SYSTEM_NXPLAYER
	select AUDIOUTILS_RTTTL_C
	---help---
		Enable an NSH command that plays RTTTL strings through the
		NuttX audio subsystem.

if SYSTEM_RTTTL

config SYSTEM_RTTTL_PROGNAME
	string "Program name"
	default "rtttl"

config SYSTEM_RTTTL_PRIORITY
	int "rtttl task priority"
	default 100

config SYSTEM_RTTTL_STACKSIZE
	int "rtttl stack size"
	default 8192

config SYSTEM_RTTTL_DEVPATH
	string "Audio device path"
	default "/dev/audio/pcm0"

config SYSTEM_RTTTL_TMPDIR
	string "Temporary raw PCM output directory"
	default "/tmp"

config SYSTEM_RTTTL_SAMPLERATE
	int "Generated sample rate"
	default 8000

config SYSTEM_RTTTL_VOLUME
	int "Default volume percent"
	default 35

endif
```

## overlays/apps/system/sdmount/Kconfig
```kconfig
############################################################################
# apps/system/sdmount/Kconfig
#
# SPDX-License-Identifier: Apache-2.0
#
############################################################################

config SYSTEM_SDMOUNT
	tristate "SD mount helper"
	default n
	depends on ADAFRUIT_FRUIT_JAM_SD_SPI || ADAFRUIT_FRUIT_JAM_SD_PIO
	---help---
		Enable the sdmount command.  On supported RP23xx boards it retries the
		board transport-neutral SD-card mount helper after boot.

if SYSTEM_SDMOUNT

config SYSTEM_SDMOUNT_PROGNAME
	string "Program name"
	default "sdmount"

config SYSTEM_SDMOUNT_PRIORITY
	int "sdmount task priority"
	default 100

config SYSTEM_SDMOUNT_STACKSIZE
	int "sdmount stack size"
	default 4096

config SYSTEM_SDMOUNT_DEVPATH
	string "Default SD block device"
	default "/dev/mmcsd0"

config SYSTEM_SDMOUNT_MOUNTPOINT
	string "Default SD mount point"
	default "/mnt/sd0"

config SYSTEM_SDMOUNT_TIMEOUT_SEC
	int "sdmount recovery timeout in seconds"
	default 12
	range 1 60
	---help---
		Reset the board if the retry mount helper does not return within this
		many seconds.  This keeps manual SD recovery attempts from leaving an
		unattended Fruit Jam stuck with no usable console.

endif
```

## overlays/apps/system/trmnl/Kconfig
```kconfig
#
# For a description of the syntax of this configuration file,
# see the file kconfig-language.txt in the NuttX tools repository.
#

config SYSTEM_TRMNL
	tristate "'trmnl' display client"
	default n
	depends on NET && NET_TCP && VIDEO_FB
	select LIBC_NETDB
	select NET_SOCKOPTS
	select NETUTILS_CJSON
	select NETUTILS_WEBCLIENT
	select LIB_ZLIB
	select CRYPTO_MBEDTLS if SYSTEM_TRMNL_ENABLE_TLS
	---help---
		Enable a small TRMNL display client for the Adafruit Fruit Jam
		RP2350 profile. The client reads device credentials from runtime
		storage, fetches /api/display, downloads the returned PNG, and
		renders it to an 800x480 FB_FMT_Y2 framebuffer.

if SYSTEM_TRMNL

config SYSTEM_TRMNL_PROGNAME
	string "Program name"
	default "trmnl"

config SYSTEM_TRMNL_PRIORITY
	int "trmnl task priority"
	default 100

config SYSTEM_TRMNL_STACKSIZE
	int "trmnl stack size"
	default 32768

config SYSTEM_TRMNL_BOOT_AUTOSTART
	bool "Autostart TRMNL from the board boot script"
	default n
	---help---
		Start the TRMNL boot command from the Fruit Jam rcS script. The
		boot command brings up the hosted Wi-Fi link when enabled, then
		enters the foreground TRMNL refresh loop in the background task
		started by rcS.

config SYSTEM_TRMNL_WIFI_AUTOSTART
	bool "Bring up hosted Wi-Fi from trmnl boot"
	default n
	depends on WIRELESS_WAPI_CMDTOOL && SYSTEM_DHCPC_RENEW
	---help---
		Allow the trmnl boot command to configure wlan0 from a small
		runtime Wi-Fi config file and renew DHCP before fetching images.

config SYSTEM_TRMNL_WIFI_IFNAME
	string "TRMNL Wi-Fi interface name"
	default "wlan0"
	depends on SYSTEM_TRMNL_WIFI_AUTOSTART

config SYSTEM_TRMNL_WIFI_CONFIG_PATH
	string "TRMNL Wi-Fi config path"
	default "/mnt/sd0/trmnl_wifi.conf"
	depends on SYSTEM_TRMNL_WIFI_AUTOSTART
	---help---
		Absolute path to a runtime Wi-Fi config. Supported keys are ssid,
		password or psk, key_mgmt, and cipher. If this file is absent,
		trmnl boot also tries SYSTEM_TRMNL_WIFI_CONFIG_LEAF inside the
		selected TRMNL data directory.

config SYSTEM_TRMNL_WIFI_CONFIG_LEAF
	string "TRMNL Wi-Fi config leaf"
	default "wifi.conf"
	depends on SYSTEM_TRMNL_WIFI_AUTOSTART

config SYSTEM_TRMNL_BOOT_WIFI_RETRIES
	int "TRMNL boot Wi-Fi retry count"
	default 8
	depends on SYSTEM_TRMNL_WIFI_AUTOSTART
	---help---
		Number of Wi-Fi bring-up attempts made by trmnl boot before it
		gives up. This absorbs early boot races where rcS starts before
		ESP-hosted has finished registering wlan0.

config SYSTEM_TRMNL_BOOT_WIFI_RETRY_DELAY
	int "TRMNL boot Wi-Fi retry delay"
	default 2
	depends on SYSTEM_TRMNL_WIFI_AUTOSTART
	---help---
		Delay in seconds between trmnl boot Wi-Fi bring-up attempts.

config SYSTEM_TRMNL_WIFI_DEFAULT_SSID
	string "Compiled fallback Wi-Fi SSID"
	default ""
	depends on SYSTEM_TRMNL_WIFI_AUTOSTART
	---help---
		Optional bring-up fallback used only when the Wi-Fi config file is
		absent. Leave empty for reusable/community builds.

config SYSTEM_TRMNL_WIFI_DEFAULT_PSK
	string "Compiled fallback Wi-Fi PSK"
	default ""
	depends on SYSTEM_TRMNL_WIFI_AUTOSTART
	---help---
		Optional bring-up fallback used only when the Wi-Fi config file is
		absent. Leave empty for reusable/community builds.

config SYSTEM_TRMNL_FB_DEVPATH
	string "Framebuffer device path"
	default "/dev/fb0"

config SYSTEM_TRMNL_SD_DATA_DIR
	string "TRMNL SD data directory"
	default "/mnt/sd0/trmnl"

config SYSTEM_TRMNL_FLASH_DATA_DIR
	string "TRMNL on-board flash data directory"
	default "/flash/trmnl"
	---help---
		Optional persistent fallback directory for credentials and state.
		The Fruit Jam board layer must mount a flash-backed filesystem at
		this path's parent directory. If the parent is absent, trmnl skips
		this location and falls back to SYSTEM_TRMNL_DATA_DIR.

config SYSTEM_TRMNL_DATA_DIR
	string "TRMNL fallback data directory"
	default "/data/trmnl"

config SYSTEM_TRMNL_MAX_JSON
	int "Maximum API JSON response bytes"
	default 8192

config SYSTEM_TRMNL_MAX_PNG
	int "Maximum downloaded PNG bytes"
	default 1048576

config SYSTEM_TRMNL_MAX_URL
	int "Maximum image URL bytes"
	default 2048

config SYSTEM_TRMNL_DEFAULT_API_URL
	string "Default TRMNL API URL"
	default "https://usetrmnl.com/api"

config SYSTEM_TRMNL_DEFAULT_ID
	string "Compiled fallback TRMNL device ID"
	default ""
	---help---
		Optional bring-up fallback used only when device.json is absent.
		Leave empty for reusable/community builds so credentials stay in
		runtime storage.

config SYSTEM_TRMNL_DEFAULT_TOKEN
	string "Compiled fallback TRMNL access token"
	default ""
	---help---
		Optional bring-up fallback used only when device.json is absent.
		Leave empty for reusable/community builds so credentials stay in
		runtime storage.

config SYSTEM_TRMNL_FW_VERSION
	string "TRMNL client firmware version header"
	default "fruitjam-nuttx-0.1"

config SYSTEM_TRMNL_MODEL
	string "TRMNL model header"
	default "fruitjam-nuttx"

config SYSTEM_TRMNL_DEFAULT_REFRESH_SEC
	int "Default refresh interval in seconds"
	default 900

config SYSTEM_TRMNL_HTTP_TIMEOUT_SEC
	int "HTTP timeout in seconds"
	default 30

config SYSTEM_TRMNL_ENABLE_TLS
	bool "Enable HTTPS through mbedTLS"
	default y

config SYSTEM_TRMNL_TLS_CA_CERT_PATH
	string "TLS CA bundle path"
	default "/mnt/sd0/trmnl/certs/roots.pem"
	depends on SYSTEM_TRMNL_ENABLE_TLS

config SYSTEM_TRMNL_TLS_ALLOW_UNVERIFIED
	bool "Allow unverified TLS certificates"
	default n
	depends on SYSTEM_TRMNL_ENABLE_TLS
	---help---
		Permit HTTPS without a CA bundle. Use only during bring-up.

config SYSTEM_TRMNL_BOOT_GUARD
	bool "Arm Fruit Jam BOOTSEL guard around TRMNL commands"
	default y
	depends on ADAFRUIT_FRUIT_JAM_RP2350_BOOT_GUARD
	---help---
		Wrap finite TRMNL commands with the Fruit Jam board boot guard.
		If a framebuffer, filesystem, HTTP, or decode path wedges, the
		board guard returns to ROM BOOTSEL instead of leaving the serial
		console stuck until a manual reset.

endif
```

## overlays/apps/system/userled/Kconfig
```kconfig
#
# For a description of the syntax of this configuration file,
# see the file kconfig-language.txt in the NuttX tools repository.
#

config SYSTEM_USERLED
	tristate "'userled' command"
	default n
	depends on USERLED
	---help---
		Enable a command that controls the NuttX user LED character
		driver.

if SYSTEM_USERLED

config SYSTEM_USERLED_PROGNAME
	string "Program name"
	default "userled"

config SYSTEM_USERLED_PRIORITY
	int "userled task priority"
	default 100

config SYSTEM_USERLED_STACKSIZE
	int "userled stack size"
	default DEFAULT_TASK_STACKSIZE

config SYSTEM_USERLED_DEVPATH
	string "User LED device path"
	default "/dev/userleds"

endif
```
