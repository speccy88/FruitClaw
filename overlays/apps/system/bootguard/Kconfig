## overlays/apps/system/bootguard/Kconfig
```kconfig
#
# For a description of the syntax of this configuration file,
# see the file kconfig-language.txt in the NuttX tools repository.
#

config SYSTEM_BOOTGUARD
	tristate "'bootguard' command"
	default n
	depends on WATCHDOG && ARCH_CHIP_RP23XX
	---help---
		Enable a command that can inspect, arm, kick, and disarm the
		RP23xx diagnostic BOOTSEL recovery guard used during board bring-up.

if SYSTEM_BOOTGUARD

config SYSTEM_BOOTGUARD_PROGNAME
	string "Program name"
	default "bootguard"

config SYSTEM_BOOTGUARD_PRIORITY
	int "bootguard task priority"
	default 100

config SYSTEM_BOOTGUARD_STACKSIZE
	int "bootguard stack size"
	default DEFAULT_TASK_STACKSIZE

config SYSTEM_BOOTGUARD_DEVPATH
	string "watchdog device path"
	default "/dev/watchdog0"

endif
```

## overlays/apps/system/bootsel/Kconfig
```kconfig
#
# For a description of the syntax of this configuration file,
# see the file kconfig-language.txt in the NuttX tools repository.
#

config SYSTEM_BOOTSEL
	tristate "'bootsel' command"
	default n
	depends on BOARDCTL_RESET
	---help---
		Enable a command that requests board reset into USB bootloader mode.
		On RP23xx boards in this checkout, reset status 3 enters BOOTSEL.

if SYSTEM_BOOTSEL

config SYSTEM_BOOTSEL_PROGNAME
	string "Program name"
	default "bootsel"

config SYSTEM_BOOTSEL_PRIORITY
	int "bootsel task priority"
	default 100

config SYSTEM_BOOTSEL_STACKSIZE
	int "bootsel stack size"
	default DEFAULT_TASK_STACKSIZE

config SYSTEM_BOOTSEL_RESET_STATUS
	int "BOARDIOC_RESET status value"
	default 3
	---help---
		Status value passed to BOARDIOC_RESET.  The RP23xx common reset
		implementation uses status 3 for ROM BOOTSEL reboot.

endif
```

## overlays/apps/system/buttonctl/Kconfig
```kconfig
#
# For a description of the syntax of this configuration file,
# see the file kconfig-language.txt in the NuttX tools repository.
#

config SYSTEM_BUTTONCTL
	tristate "'buttonctl' command"
	default n
	depends on INPUT_BUTTONS
	---help---
		Enable a command that reads the NuttX buttons character driver.

if SYSTEM_BUTTONCTL

config SYSTEM_BUTTONCTL_PROGNAME
	string "Program name"
	default "buttonctl"

config SYSTEM_BUTTONCTL_PRIORITY
	int "buttonctl task priority"
	default 100

config SYSTEM_BUTTONCTL_STACKSIZE
	int "buttonctl stack size"
	default DEFAULT_TASK_STACKSIZE

config SYSTEM_BUTTONCTL_DEVPATH
	string "Buttons device path"
	default "/dev/buttons"

endif
```

## overlays/apps/system/dvictrl/Kconfig
```kconfig
#
# For a description of the syntax of this configuration file,
# see the file kconfig-language.txt in the NuttX tools repository.
#

config SYSTEM_DVICTRL
	tristate "'dvictrl' command"
	default n
	depends on VIDEO_FB
	---help---
		Enable a command that controls and tests a framebuffer-backed
		DVI display.

if SYSTEM_DVICTRL

config SYSTEM_DVICTRL_PROGNAME
	string "Program name"
	default "dvictrl"

config SYSTEM_DVICTRL_PRIORITY
	int "dvictrl task priority"
	default 100

config SYSTEM_DVICTRL_STACKSIZE
	int "dvictrl stack size"
	default DEFAULT_TASK_STACKSIZE

config SYSTEM_DVICTRL_DEVPATH
	string "Framebuffer device path"
	default "/dev/fb0"

config SYSTEM_DVICTRL_START_GUARD
	bool "Guard DVI start with watchdog"
	default y
	depends on WATCHDOG
	---help---
		Arm the watchdog boot guard before enabling DVI output.  On the
		Fruit Jam board this lets a failed DVI start reset into BOOTSEL
		automatically instead of requiring the BOOTSEL button.

if SYSTEM_DVICTRL_START_GUARD

config SYSTEM_DVICTRL_GUARD_DEVPATH
	string "Watchdog device path for DVI start guard"
	default "/dev/watchdog0"

config SYSTEM_DVICTRL_GUARD_TIMEOUT_MS
	int "DVI start guard timeout in milliseconds"
	default 8000
	range 1000 16000
	---help---
		The RP23xx watchdog hardware limit is about 16 seconds.  Keep this
		long enough for the DVI start ioctl and settle window to complete.

config SYSTEM_DVICTRL_GUARD_SETTLE_MS
	int "DVI start settle window in milliseconds"
	default 3000
	range 0 15000
	---help---
		After FBIOSET_POWER(1) returns, keep the guard armed for this long
		so early DMA/HSTX stalls still recover into BOOTSEL.

endif

endif
```

## overlays/apps/system/esphostedctl/Kconfig
```kconfig
#
# For a description of the syntax of this configuration file,
# see the file kconfig-language.txt in the NuttX tools repository.
#

config SYSTEM_ESPHOSTEDCTL
	tristate "'esphostedctl' command"
	default n
	depends on ESP_HOSTED
	---help---
		Enable a command that prints ESP-Hosted transport and wlan driver
		counters.

if SYSTEM_ESPHOSTEDCTL

config SYSTEM_ESPHOSTEDCTL_PROGNAME
	string "Program name"
	default "esphostedctl"

config SYSTEM_ESPHOSTEDCTL_PRIORITY
	int "esphostedctl task priority"
	default 100

config SYSTEM_ESPHOSTEDCTL_STACKSIZE
	int "esphostedctl stack size"
	default DEFAULT_TASK_STACKSIZE

endif
```
