## profiles/pico-2-w-network/defconfig
```kconfig
# NuttX RP2350: Raspberry Pi Pico 2 W low-footprint CYW43439 network profile

CONFIG_ALLOW_BSD_COMPONENTS=y
CONFIG_ARCH="arm"
CONFIG_ARCH_BOARD="raspberrypi-pico-2-w"
CONFIG_ARCH_BOARD_RASPBERRYPI_PICO_2_W=y
CONFIG_ARCH_BOARD_COMMON=y
CONFIG_ARCH_CHIP="rp23xx"
CONFIG_ARCH_CHIP_RP23XX=y
CONFIG_ARCH_INTERRUPTSTACK=2048
CONFIG_ARCH_RAMVECTORS=y
CONFIG_ARCH_SETJMP_H=y
CONFIG_ARCH_STACKDUMP=y
CONFIG_ARCH_TOOLCHAIN_GCC=y
CONFIG_ARCH_TOOLCHAIN_GNU=y
CONFIG_ARM_TOOLCHAIN_GNU_EABI=y
CONFIG_BOARD_LOOPSPERMSEC=10450
CONFIG_BOARDCTL_RESET=y
CONFIG_BOARDCTL_IOCTL=y
CONFIG_BUILTIN=y
CONFIG_DEFAULT_TASK_STACKSIZE=4096
CONFIG_IDLETHREAD_STACKSIZE=2048
CONFIG_INIT_ENTRYPOINT="nsh_main"
CONFIG_INIT_STACKSIZE=4096
CONFIG_RAM_START=0x20000000
CONFIG_RAM_SIZE=532480
# CONFIG_RP23XX_UART0 is not set
# CONFIG_DEV_CONSOLE is not set

CONFIG_USBDEV=y
CONFIG_USBDEV_BUSPOWERED=y
CONFIG_CDCACM=y
CONFIG_CDCACM_CONSOLE=y
CONFIG_CDCACM_BOOTSEL_TOUCH=y
CONFIG_CDCACM_BOOTSEL_TOUCH_RESET_STATUS=3
CONFIG_SERIAL_TERMIOS=y
CONFIG_TTY_SIGINT=y
CONFIG_TTY_SIGINT_CHAR=0x03
CONFIG_SCHED_HPWORK=y
CONFIG_SCHED_LPWORK=y
CONFIG_SCHED_WAITPID=y
CONFIG_SIG_DEFAULT=y
CONFIG_RR_INTERVAL=200

CONFIG_FS_PROCFS=y
CONFIG_FS_PROCFS_REGISTER=y
CONFIG_FS_TMPFS=y
CONFIG_FS_ROMFS=y
CONFIG_ETC_ROMFS=y
CONFIG_LIBC_PERROR_STDOUT=y
CONFIG_LIBC_STRERROR=y
CONFIG_NFILE_DESCRIPTORS_PER_BLOCK=12
CONFIG_LINE_MAX=256

CONFIG_NSH_ARCHINIT=y
CONFIG_NSH_BUILTIN_APPS=y
CONFIG_NSH_FILEIOSIZE=512
CONFIG_NSH_READLINE=y
CONFIG_NSH_STRERROR=y
CONFIG_NSH_USBCONSOLE=y
CONFIG_NSH_USBCONSOLE_CONNECT_DELAY=500
CONFIG_NSH_USBCONSOLE_WAIT_DTR=y
CONFIG_NSH_USBCONSOLE_WAIT_DTR_TIMEOUT=5000
# CONFIG_NSH_USBCONSOLE_WAIT_INPUT is not set
# CONFIG_NSH_DISABLE_IFCONFIG is not set
# CONFIG_NSH_DISABLE_DATE is not set
# CONFIG_NSH_DISABLE_WGET is not set
# CONFIG_NSH_NETINIT is not set
CONFIG_READLINE_TABCOMPLETION=y
CONFIG_READLINE_CMD_HISTORY=y
CONFIG_READLINE_CMD_HISTORY_LINELEN=256
CONFIG_READLINE_CMD_HISTORY_LEN=32

CONFIG_INTERPRETERS_BERRY=y
CONFIG_INTERPRETERS_BERRY_STACKSIZE=8192
CONFIG_SYSTEM_NSH=y
CONFIG_SYSTEM_NSH_STACKSIZE=4096
CONFIG_SYSTEM_VI=y
CONFIG_SYSTEM_VI_COLS=80
CONFIG_SYSTEM_VI_ROWS=24
CONFIG_SYSTEM_VI_STACKSIZE=4096
CONFIG_SYSTEM_I2CTOOL=y
CONFIG_SYSTEM_DUMPSTACK=y
CONFIG_SYSTEM_SYSTEM=y
CONFIG_SYSTEM_BOOTSEL=y

CONFIG_RP23XX_I2C=y
CONFIG_RP23XX_I2C0=y
CONFIG_RP23XX_I2C0_SDA_GPIO=4
CONFIG_RP23XX_I2C0_SCL_GPIO=5
CONFIG_RP23XX_I2C_DRIVER=y
CONFIG_DRIVERS_WIRELESS=y
CONFIG_DRIVERS_IEEE80211=y
CONFIG_RP23XX_INFINEON_CYW43439=y
CONFIG_IEEE80211_INFINEON_CYW43439=y
CONFIG_IEEE80211_BROADCOM_FULLMAC_GSPI=y
CONFIG_IEEE80211_BROADCOM_DEFAULT_COUNTRY="XX"
CONFIG_IEEE80211_BROADCOM_DMABUF_ALIGNMENT=16
CONFIG_IEEE80211_BROADCOM_FRAME_POOL_SIZE=32

CONFIG_NET=y
CONFIG_NET_IPv4=y
CONFIG_NET_LOOPBACK=y
CONFIG_NETDEV_LATEINIT=y
CONFIG_NETDEV_WIRELESS_IOCTL=y
CONFIG_NET_BROADCAST=y
CONFIG_NET_PREALLOC_DEVIF_CALLBACKS=32
CONFIG_NET_ALLOC_DEVIF_CALLBACKS=16
CONFIG_NET_TCP=y
CONFIG_NET_TCP_DELAYED_ACK=y
CONFIG_NET_TCP_PREALLOC_CONNS=32
CONFIG_NET_TCP_ALLOC_CONNS=8
CONFIG_NET_TCP_MAX_CONNS=64
CONFIG_NET_TCP_NPOLLWAITERS=24
CONFIG_NET_TCPBACKLOG_CONNS=32
CONFIG_NET_TCP_WAIT_TIMEOUT=2
CONFIG_NET_TCP_WRITE_BUFFERS=y
CONFIG_NET_SEND_BUFSIZE=8192
CONFIG_NET_MAX_SEND_BUFSIZE=16384
CONFIG_NET_RECV_BUFSIZE=8192
CONFIG_NET_MAX_RECV_BUFSIZE=16384
CONFIG_NET_TCP_NWRBCHAINS=32
CONFIG_NET_TCP_ALLOC_WRBCHAINS=8
CONFIG_NET_UDP=y
CONFIG_NET_ICMP_SOCKET=y
CONFIG_NETDB_DNSCLIENT=y
CONFIG_NETDB_DNSCLIENT_RECV_TIMEOUT=3
CONFIG_NET_ARP_SEND_QUEUE=y
CONFIG_ARP_SEND_MAXTRIES=10
CONFIG_ARP_SEND_DELAYMSEC=100
CONFIG_IOB_NBUFFERS=512
CONFIG_IOB_BUFSIZE=256
CONFIG_IOB_NCHAINS=128

CONFIG_NETUTILS_DHCPC=y
CONFIG_NETUTILS_FTPC=y
CONFIG_NETUTILS_FTPD=y
CONFIG_NETUTILS_NETCAT=y
CONFIG_NETUTILS_NTPCLIENT=y
CONFIG_NETUTILS_TELNETD=y
CONFIG_TELNET_SEND_TIMEOUT_MS=5000
CONFIG_NETUTILS_WEBCLIENT=y
CONFIG_NETUTILS_WEBSERVER=y
# CONFIG_NETUTILS_HTTPD_SINGLECONNECT is not set
CONFIG_NETUTILS_HTTPD_TIMEOUT=3
CONFIG_NETUTILS_NETCAT_BUFSIZE=1460
CONFIG_FTPD_CMDBUFFERSIZE=512
CONFIG_FTPD_DATABUFFERSIZE=4096
CONFIG_FTPD_CONTROL_TIMEOUT_MS=300000
CONFIG_FTPD_DATA_TIMEOUT_MS=15000
CONFIG_FTPD_PASV_TIMEOUT_MS=10000
CONFIG_EXAMPLES_FTPD_ROOT="/tmp"
# CONFIG_NETUTILS_MQTTC is not set
CONFIG_EXAMPLES_FTPC=y
CONFIG_EXAMPLES_FTPD=y
CONFIG_EXAMPLES_WEBSERVER=y
# CONFIG_EXAMPLES_MQTTC is not set
CONFIG_SYSTEM_DHCPC_RENEW=y
CONFIG_SYSTEM_NTPC=y
CONFIG_SYSTEM_PING=y
CONFIG_SYSTEM_TELNETD=y
CONFIG_SYSTEM_TELNET_CLIENT=y
CONFIG_SYSTEM_WIFIASSOC=y
CONFIG_SYSTEM_WIFIASSOC_BOARDINIT=y
CONFIG_SYSTEM_WIFIASSOC_BOARDINIT_ARG=1
CONFIG_WIRELESS_WAPI=y
CONFIG_WIRELESS_WAPI_CMDTOOL=y

CONFIG_WATCHDOG=y
CONFIG_SYSTEM_RP2350WATCHDOG=y
CONFIG_SYSTEM_RP2350WATCHDOG_PRIORITY=110
CONFIG_SYSTEM_RP2350WATCHDOG_TIMEOUT_MS=15000
CONFIG_SYSTEM_RP2350WATCHDOG_PING_MS=5000
# CONFIG_SYSTEM_RP2350WATCHDOG_BOOTSEL_RECOVERY is not set
CONFIG_SYSTEM_RP2350WATCHDOG_DEV_BOOTSEL_MS=0
# CONFIG_RP23XX_AUTO_BOOTSEL_ON_BOOT is not set

# CONFIG_NETINIT_WAPI_SSID is not set
# CONFIG_NETINIT_WAPI_PASSPHRASE is not set
# CONFIG_RP23XX_PSRAM is not set
# CONFIG_RP23XX_SPISD is not set
# CONFIG_RP23XX_HSTX_DVI is not set
# CONFIG_AUDIO is not set
# CONFIG_USBHOST is not set
```
