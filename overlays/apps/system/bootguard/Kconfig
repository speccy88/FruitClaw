## overlays/apps/system/wifiassoc/Kconfig
```kconfig
config SYSTEM_WIFIASSOC
	tristate "WiFi association helper"
	default n
	depends on WIRELESS_WAPI && NETUTILS_DHCPC
	---help---
		Enable a small NSH helper that associates a wireless interface with
		a WPA2/CCMP network and optionally runs DHCP.

if SYSTEM_WIFIASSOC

config SYSTEM_WIFIASSOC_PROGNAME
	string "Program name"
	default "wifiassoc"

config SYSTEM_WIFIASSOC_PRIORITY
	int "Task priority"
	default 100

config SYSTEM_WIFIASSOC_STACKSIZE
	int "Stack size"
	default DEFAULT_TASK_STACKSIZE

config SYSTEM_WIFIASSOC_ASSOC_RETRIES
	int "Association retries"
	default 5
	---help---
		Number of times to retry the WAPI association sequence before
		failing.

config SYSTEM_WIFIASSOC_ASSOC_DELAY_MS
	int "Delay before each association attempt"
	default 1500
	---help---
		Delay between association attempts.  The RP2350 Pico W Broadcom
		interface can need a short settling period after wlan0 is brought up.

config SYSTEM_WIFIASSOC_DHCP_RETRIES
	int "DHCP retries"
	default 5

config SYSTEM_WIFIASSOC_DHCP_DELAY_MS
	int "Delay before each DHCP attempt"
	default 1500

config SYSTEM_WIFIASSOC_BOARDINIT
	bool "Request board wireless initialization before association"
	default n
	depends on BOARDCTL && BOARDCTL_IOCTL
	---help---
		Call a board-specific BOARDIOC_USER command before bringing up the
		wireless interface.  This lets WiFi hardware initialization remain
		deferred until association, so the USB console can enumerate first.

config SYSTEM_WIFIASSOC_BOARDINIT_ARG
	int "BOARDIOC_USER command offset for WiFi association"
	default 0
	depends on SYSTEM_WIFIASSOC_BOARDINIT
	---help---
		Offset added to BOARDIOC_USER for the board's WiFi initialization
		command.  Pico 2 W uses offset 1.

endif
```

## overlays/nuttx/boards/arm/rp23xx/adafruit-fruit-jam-rp2350/Kconfig
```kconfig
#
# For a description of the syntax of this configuration file,
# see the file kconfig-language.txt in the NuttX tools repository.
#

if ARCH_BOARD_ADAFRUIT_FRUIT_JAM_RP2350

config ADAFRUIT_FRUIT_JAM_RP2350_NINA
	bool "Enable onboard ESP32-C6 NINA wiring"
	default n
	---help---
		Enable this later when the board port grows the ESP32-C6/NINA
		networking path.  The first bring-up keeps networking disabled.

config ADAFRUIT_FRUIT_JAM_RP2350_ESP_HOSTED
	bool "Enable ESP-Hosted ESP32-C6 support"
	default n
	depends on ESP_HOSTED_SPI && RP23XX_SPI1
	select ADAFRUIT_FRUIT_JAM_RP2350_NINA
	---help---
		Build support for using the onboard ESP32-C6 pins as an
		ESP-Hosted-MCU style Wi-Fi coprocessor over SPI1.  This is the
		raw-frame hosted path intended to become a true wlan0 NuttX network
		interface, not the Adafruit NINA socket-command protocol.

if ADAFRUIT_FRUIT_JAM_RP2350_ESP_HOSTED

config ADAFRUIT_FRUIT_JAM_RP2350_ESP_HOSTED_AUTOSTART
	bool "Automatically start ESP-Hosted during board bring-up"
	default n
	---help---
		Start the ESP-Hosted SPI transport from board bring-up.  Keep this
		disabled while validating the coprocessor firmware and SPI handshake
		so USB CDC/NSH remains available for recovery.

config ADAFRUIT_FRUIT_JAM_RP2350_ESP_HOSTED_START_DELAY_MS
	int "ESP-Hosted deferred start delay in milliseconds"
	default 2500
	depends on ADAFRUIT_FRUIT_JAM_RP2350_ESP_HOSTED_AUTOSTART
	---help---
		Delay ESP-Hosted initialization so USB CDC/NSH can become
		interactive before the ESP32-C6 SPI control path starts.  This
		keeps the recovery shell available during coprocessor bring-up.

endif

config ADAFRUIT_FRUIT_JAM_RP2350_BOOT_DIAG
	bool "Enable early GPIO29 boot diagnostic"
	default n
	---help---
		Drive the active-low red LED as soon as the board-specific early
		initialization hook runs.  This is useful while bringing up USB
		console images that may fail before a serial console is available.

config ADAFRUIT_FRUIT_JAM_RP2350_BOOT_GUARD
	bool "Enable diagnostic BOOTSEL recovery guard"
	default n
	depends on BOARDCTL_RESET
	select SCHED_HPWORK
	select WATCHDOG
	---help---
		Arm the RP23xx watchdog and a delayed BOOTSEL recovery worker early
		in board start-up.  This is intended for unattended bring-up images:
		if the image hangs before NSH is reachable, the next watchdog reset
		enters BOOTSEL instead of endlessly rebooting the same image.  When
		USB CDC/ACM minor 0 is configured by the host, the board disarms the
		guard automatically.

if ADAFRUIT_FRUIT_JAM_RP2350_BOOT_GUARD

config ADAFRUIT_FRUIT_JAM_RP2350_BOOT_GUARD_TIMEOUT_MS
	int "Diagnostic BOOTSEL recovery timeout in milliseconds"
	default 15000
	range 1000 600000
	---help---
		Diagnostic recovery guard deadline.  The RP23xx watchdog hardware
		can only hold about 16 seconds at a time; the board guard refreshes
		that short watchdog from HPWORK until this longer deadline expires.

config ADAFRUIT_FRUIT_JAM_RP2350_BOOT_GUARD_CDC_DISARM
	bool "Disarm BOOTSEL recovery guard when CDC connects"
	default y
	depends on CDCACM
	---help---
		Automatically clear the early BOOTSEL recovery guard when USB CDC/ACM
		minor 0 is configured by the host.  This is convenient for plain NSH
		bring-up images where an interactive console is the success signal.
		Disable this for unattended FruitClaw operator images: a stale CDC
		device is not enough proof that the agent, Wi-Fi, HTTPD, Telegram, or
		watchdog keepalive path is healthy.

endif

config ADAFRUIT_FRUIT_JAM_RP2350_IR_RX
	bool "Enable GPIO29 IR receiver"
	default n
	depends on DRIVERS_RC
	---help---
		Register the Fruit Jam GPIO29 shared LED/IR pin as a raw LIRC
		receiver at /dev/lirc0.  Enable this instead of USERLED support
		when the IR receiver should own the pin.

config ADAFRUIT_FRUIT_JAM_RP2350_EXAMPLES_ROMFS
	bool "Mount baked example scripts at /examples"
	default n
	depends on !DISABLE_MOUNTPOINT
	select FS_ROMFS
	---help---
		Mount a board-local ROMFS image containing Fruit Jam helper
		scripts and demonstrations at /examples.

if ADAFRUIT_FRUIT_JAM_RP2350_EXAMPLES_ROMFS

config RP23XX_ROMFS_ROMDISK_MINOR
	int "ROMFS RAM disk minor"
	default 0

config RP23XX_ROMFS_ROMDISK_DEVNAME
	string "ROMFS RAM disk device name"
	default "/dev/ram0"

config RP23XX_ROMFS_ROMDISK_SECTSIZE
	int "ROMFS RAM disk sector size"
	default 512

config RP23XX_ROMFS_MOUNT_MOUNTPOINT
	string "ROMFS mount point"
	default "/examples"

endif

config RP23XX_WS2812_GPIO_PIN
	default 32 if RP23XX_BOARD_HAS_WS2812

config RP23XX_WS2812_PWR_GPIO
	default -1 if RP23XX_BOARD_HAS_WS2812

config WS2812_LED_COUNT
	default 5 if RP23XX_BOARD_HAS_WS2812

config RP23XX_I2C0_SDA_GPIO
	default 20 if RP23XX_I2C0

config RP23XX_I2C0_SCL_GPIO
	default 21 if RP23XX_I2C0

config RP23XX_SPI0_RX_GPIO
	default 36 if RP23XX_SPI0

config RP23XX_SPI0_CS_GPIO
	default 39 if RP23XX_SPI0

config RP23XX_SPI0_SCK_GPIO
	default 34 if RP23XX_SPI0

config RP23XX_SPI0_TX_GPIO
	default 35 if RP23XX_SPI0

config RP23XX_SPI1_RX_GPIO
	default 28 if RP23XX_SPI1

config RP23XX_SPI1_CS_GPIO
	default 46 if RP23XX_SPI1

config RP23XX_SPI1_SCK_GPIO
	default 30 if RP23XX_SPI1

config RP23XX_SPI1_TX_GPIO
	default 31 if RP23XX_SPI1

config RP23XX_SPISD_SPI_CH
	default 0 if RP23XX_SPISD

endif
```

## overlays/nuttx/boards/arm/rp23xx/adafruit-fruit-jam-rp2350/esp-hosted-mcu/sdkconfig.defaults.fruitjam-esp32c6
```kconfig
# Fruit Jam ESP32-C6 ESP-Hosted-MCU slave overlay.
#
# Apply on top of upstream esp-hosted-mcu/slave defaults:
#
#   sdkconfig.defaults
#   sdkconfig.defaults.esp32c6
#   sdkconfig.defaults.fruitjam-esp32c6
#
# The RP2350 host-side NuttX driver currently implements ESP-Hosted standard
# SPI full-duplex framing, so keep this on CONFIG_ESP_SPI_HOST_INTERFACE.

CONFIG_ESP_HOST_DEV_BOARD_NONE=y
CONFIG_ESP_HOSTED_CP_WIFI=y
CONFIG_ESP_HOSTED_CP_BT=n
CONFIG_BT_ENABLED=n

CONFIG_ESP_SPI_HOST_INTERFACE=y
# CONFIG_ESP_SDIO_HOST_INTERFACE is not set
# CONFIG_ESP_SPI_HD_HOST_INTERFACE is not set
# CONFIG_ESP_UART_HOST_INTERFACE is not set

CONFIG_SPI_HSPI=y
CONFIG_ESP_SPI_PRIV_MODE_3=y

# Adafruit Fruit Jam schematic:
#   RP2350 GPIO31 MOSI -> ESP32-C6 IO21
#   RP2350 GPIO28 MISO <- ESP32-C6 IO6 through ESP_MISO buffer
#   RP2350 GPIO30 SCK  -> ESP32-C6 IO22
#   RP2350 GPIO46 CS   -> ESP32-C6 IO7
CONFIG_ESP_SPI_HSPI_GPIO_MOSI=21
CONFIG_ESP_SPI_HSPI_GPIO_MISO=6
CONFIG_ESP_SPI_HSPI_GPIO_CLK=22
CONFIG_ESP_SPI_HSPI_GPIO_CS=7

# ESP_BUSY is C6 IO18 to RP2350 GPIO3. I2S_ESP_IRQ is C6 IO9/BOOT9 to
# RP2350 GPIO23, so the host must leave it as an input during C6 boot.
CONFIG_ESP_SPI_GPIO_HANDSHAKE=18
CONFIG_ESP_SPI_GPIO_DATA_READY=9

# Fruit Jam drives the C6 EN pin through RP2350 GPIO22/PERIPH_RST rather than
# through a normal ESP32-C6 GPIO.
CONFIG_ESP_SPI_GPIO_RESET=-1

CONFIG_ESP_SPI_DEASSERT_HS_ON_CS=y
CONFIG_ESP_SPI_CHECKSUM=y
CONFIG_WIFI_CMD_BASIC_ONLY=y
```

## overlays/nuttx/boards/arm/rp23xx/raspberrypi-pico-2-w/Kconfig
```kconfig
#
# For a description of the syntax of this configuration file,
# see the file kconfig-language.txt in the NuttX tools repository.
#

if ARCH_BOARD_RASPBERRYPI_PICO_2_W

config RP23XX_PICO_BOOTSEL_ON_WATCHDOG
	bool "Enter BOOTSEL after a marked watchdog reset"
	default n
	depends on BOARDCTL_RESET
	---help---
		Development-only recovery support.  If the RP2350 watchdog resets the
		board while the NuttX RP2350 development guard magic is present, enter
		ROM BOOTSEL during the next early boot.  Canonical release profiles
		must keep this disabled.

config RP23XX_AUTO_BOOTSEL_ON_BOOT
	bool "Automatically reboot to ROM BOOTSEL during board initialization"
	default n
	depends on BOARDCTL_RESET
	---help---
		Enable this only for recovery/test images.  When selected, the board
		immediately reboots itself into the RP2350 ROM BOOTSEL USB loader
		during board initialization, without waiting for NSH or USB CDC.

menuconfig RP23XX_INFINEON_CYW43439
	bool "Has Infineon CYW43439 WiFi chip"
	depends on IEEE80211_INFINEON_CYW43439
	default y

endif

if RP23XX_INFINEON_CYW43439

config CYW43439_FIRMWARE_BIN_PATH
	string "Path to Infineon 43439 combined firmware binary"
	default "${PICO_SDK_PATH}/lib/cyw43-driver/firmware/43439A0-7.95.49.00.combined"
	---help---
		Path to a real CYW43439 combined firmware binary containing the
		padded firmware followed by the CLM blob.

config CYW43439_FIRMWARE_HEADER_PATH
	string "Path to Infineon 43439 combined firmware header"
	default "${PICO_SDK_PATH}/lib/cyw43-driver/firmware/w43439A0_7_95_49_00_combined.h"
	---help---
		Path to the Pico SDK header form of the same combined firmware blob.
		The board Makefile can extract this header to a binary image when
		the binary path above is not present.

config CYW43439_FIRMWARE_LEN
	int "Infineon 43439 firmware length (bytes)"
	default 224190
	---help---
		This is the length of just the base firmware in the firmware image.
		It does not include padding nor the appended CLM blob.

endif
```

## profiles/fruit-jam-doom/defconfig
```kconfig
# NuttX RP2350: Adafruit Fruit Jam focused NXDoom release profile
# Keyboard is preserved; mouse and game-audio runtime integration remain pending.

CONFIG_ALLOW_BSD_COMPONENTS=y
CONFIG_ALLOW_GPL_COMPONENTS=y
CONFIG_ARCH="arm"
CONFIG_ARCH_BOARD="adafruit-fruit-jam-rp2350"
CONFIG_ARCH_BOARD_ADAFRUIT_FRUIT_JAM_RP2350=y
CONFIG_ARCH_BOARD_COMMON=y
CONFIG_ARCH_CHIP="rp23xx"
CONFIG_ARCH_CHIP_RP23XX=y
CONFIG_ARCH_INTERRUPTSTACK=2048
CONFIG_ARCH_RAMVECTORS=y
CONFIG_ARCH_SETJMP_H=y
CONFIG_ARCH_STACKDUMP=y
CONFIG_ARCH_TOOLCHAIN_GCC=y
CONFIG_ARCH_TOOLCHAIN_GNU=y
CONFIG_ARM_TOOLCHAIN_GNU_EABI=y
CONFIG_BOARD_LOOPSPERMSEC=10450
CONFIG_BOARDCTL_RESET=y
CONFIG_BUILTIN=y
CONFIG_DEFAULT_TASK_STACKSIZE=4096
CONFIG_IDLETHREAD_STACKSIZE=2048
CONFIG_INIT_ENTRYPOINT="nsh_main"
CONFIG_INIT_STACKSIZE=8192
CONFIG_RAM_START=0x20000000
CONFIG_RAM_SIZE=532480
CONFIG_RP23XX_RP2350B=y
# CONFIG_RP23XX_UART0 is not set
# CONFIG_DEV_CONSOLE is not set

CONFIG_USBDEV=y
CONFIG_USBDEV_BUSPOWERED=y
CONFIG_CDCACM=y
CONFIG_CDCACM_CONSOLE=y
CONFIG_CDCACM_BOOTSEL_TOUCH=y
CONFIG_CDCACM_BOOTSEL_TOUCH_RESET_STATUS=3
CONFIG_SERIAL_TERMIOS=y
CONFIG_TTY_SIGINT=y
CONFIG_TTY_SIGINT_CHAR=0x03
CONFIG_SCHED_HPWORK=y
CONFIG_SCHED_LPWORK=y
CONFIG_SCHED_WAITPID=y
CONFIG_SIG_DEFAULT=y

CONFIG_FS_FAT=y
CONFIG_FS_FATTIME=y
CONFIG_FAT_LFN=y
CONFIG_FS_PROCFS=y
CONFIG_FS_PROCFS_REGISTER=y
CONFIG_FS_TMPFS=y
CONFIG_FS_ROMFS=y
CONFIG_ETC_ROMFS=y
CONFIG_MMCSD=y
CONFIG_MMCSD_PROCFS=y
CONFIG_CRYPTO=y
CONFIG_LIBC_FLOATINGPOINT=y
CONFIG_LIBC_LOCALE=y
CONFIG_LIBC_PERROR_STDOUT=y
CONFIG_LIBC_STRERROR=y
CONFIG_NFILE_DESCRIPTORS_PER_BLOCK=12
CONFIG_LINE_MAX=256
CONFIG_MM_KERNEL_HEAP=y
CONFIG_MM_KERNEL_HEAPSIZE=65536

CONFIG_NSH_BUILTIN_APPS=y
CONFIG_NSH_FILEIOSIZE=512
CONFIG_NSH_READLINE=y
CONFIG_NSH_STRERROR=y
CONFIG_NSH_USBCONSOLE=y
CONFIG_NSH_USBCONSOLE_CONNECT_DELAY=500
CONFIG_NSH_USBCONSOLE_WAIT_DTR=y
CONFIG_NSH_USBCONSOLE_WAIT_DTR_TIMEOUT=5000
# CONFIG_NSH_USBCONSOLE_WAIT_INPUT is not set
CONFIG_READLINE_TABCOMPLETION=y
CONFIG_READLINE_CMD_HISTORY=y
CONFIG_READLINE_CMD_HISTORY_LINELEN=256
CONFIG_READLINE_CMD_HISTORY_LEN=32
CONFIG_INTERPRETERS_BERRY=y
CONFIG_INTERPRETERS_BERRY_STACKSIZE=8192
CONFIG_SYSTEM_NSH=y
CONFIG_SYSTEM_NSH_STACKSIZE=8192
CONFIG_SYSTEM_VI=y
CONFIG_SYSTEM_VI_COLS=80
CONFIG_SYSTEM_VI_ROWS=24
CONFIG_SYSTEM_VI_STACKSIZE=4096
CONFIG_SYSTEM_I2CTOOL=y
CONFIG_SYSTEM_SPITOOL=y
CONFIG_SYSTEM_DUMPSTACK=y
CONFIG_SYSTEM_SYSTEM=y
CONFIG_SYSTEM_BOOTSEL=y

CONFIG_RP23XX_I2C=y
CONFIG_RP23XX_I2C0=y
CONFIG_RP23XX_I2C0_SDA_GPIO=20
CONFIG_RP23XX_I2C0_SCL_GPIO=21
CONFIG_RP23XX_I2C_DRIVER=y
CONFIG_RP23XX_SPI=y
CONFIG_RP23XX_SPI0=y
CONFIG_RP23XX_SPISD=y
CONFIG_RP23XX_SPI0_RX_GPIO=36
CONFIG_RP23XX_SPI0_CS_GPIO=39
CONFIG_RP23XX_SPI0_SCK_GPIO=34
CONFIG_RP23XX_SPI0_TX_GPIO=35

CONFIG_RP23XX_PSRAM=y
CONFIG_RP23XX_PSRAM_CS1_GPIO=47
CONFIG_RP23XX_PSRAM_HEAP_USER=y
CONFIG_RP23XX_PSRAM_SIZE=8388608
CONFIG_RP23XX_PSRAM_WAIT_TIMEOUT=1000000
CONFIG_DRIVERS_VIDEO=y
CONFIG_VIDEO_FB=y
CONFIG_FB_UPDATE=y
CONFIG_RP23XX_HSTX_DVI=y
CONFIG_RP23XX_HSTX_DVI_BOOT_AUTOSTART=y
CONFIG_RP23XX_HSTX_DVI_FB_RGB565_320X240=y
CONFIG_RP23XX_HSTX_DVI_OUTPUT_SCALING=2
CONFIG_RP23XX_HSTX_DVI_PIXEL_CLOCK=25200000
CONFIG_RP23XX_HSTX_DVI_SCANOUT_PSRAM=y
CONFIG_RP23XX_HSTX_DVI_SINGLE_SCANOUT_INTERNAL=y
CONFIG_SYSTEM_DVICTRL=y
# CONFIG_SYSTEM_DVICTRL_START_GUARD is not set

CONFIG_INPUT=y
CONFIG_INPUT_KEYBOARD=y
CONFIG_INPUT_MOUSE=y
CONFIG_INPUT_MOUSE_WHEEL=y
CONFIG_USBHOST=y
CONFIG_USBHOST_WAITER=y
CONFIG_USBHOST_WAITER_PRIO=100
CONFIG_USBHOST_WAITER_STACKSIZE=4096
CONFIG_USBHOST_HUB=y
CONFIG_USBHOST_COMPOSITE=y
CONFIG_USBHOST_HID=y
CONFIG_USBHOST_HIDKBD=y
CONFIG_USBHOST_HIDMOUSE=y
CONFIG_HIDKBD_INPUT=y
CONFIG_HIDKBD_INPUT_DEVPATH="/dev/kbd0"
CONFIG_HIDKBD_INPUT_DOSKEYS=y
CONFIG_HIDKBD_NOGETREPORT=y
CONFIG_RP23XX_PIO_USBHOST=y
CONFIG_RP23XX_PIO_USBHOST_DP_GPIO=1
CONFIG_RP23XX_PIO_USBHOST_DM_GPIO=2
CONFIG_RP23XX_PIO_USBHOST_VBUS_GPIO=11
CONFIG_RP23XX_PIO_USBHOST_PIO=0
CONFIG_RP23XX_PIO_USBHOST_TX_SM=0
CONFIG_RP23XX_PIO_USBHOST_RX_SM=1
CONFIG_RP23XX_PIO_USBHOST_EOP_SM=2
CONFIG_RP23XX_PIO_USBHOST_DMA_CHANNEL=9
CONFIG_RP23XX_PIO_USBHOST_FRAME_IRQ=y
CONFIG_SYSTEM_PIOUSBHOST=y

CONFIG_AUDIO=y
CONFIG_AUDIO_FORMAT_PCM=y
CONFIG_AUDIO_FORMAT_RAW=y
CONFIG_AUDIO_I2S=y
CONFIG_AUDIO_I2SCHAR=y
CONFIG_DRIVERS_AUDIO=y
CONFIG_RP23XX_I2S=y
CONFIG_RP23XX_I2S_CLOCK=26
CONFIG_RP23XX_I2S_DATA=24
CONFIG_RP23XX_I2S_PIO=1
CONFIG_SYSTEM_NXPLAYER=y

CONFIG_GAMES_NXDOOM=y
CONFIG_GAMES_NXDOOM_FBPATH="/dev/fb0"
CONFIG_GAMES_NXDOOM_KBDPATH="/dev/kbd0"
CONFIG_GAMES_NXDOOM_KEYBOARD=y
CONFIG_GAMES_NXDOOM_PREFDIR="/data"
CONFIG_GAMES_NXDOOM_STACKSIZE=16384
# CONFIG_GAMES_NXDOOM_NET is not set
# CONFIG_GAMES_NXDOOM_SOUND is not set

CONFIG_WATCHDOG=y
CONFIG_SYSTEM_RP2350WATCHDOG=y
CONFIG_SYSTEM_RP2350WATCHDOG_TIMEOUT_MS=15000
CONFIG_SYSTEM_RP2350WATCHDOG_PING_MS=5000
# CONFIG_SYSTEM_RP2350WATCHDOG_BOOTSEL_RECOVERY is not set
CONFIG_SYSTEM_RP2350WATCHDOG_DEV_BOOTSEL_MS=0
# CONFIG_ADAFRUIT_FRUIT_JAM_RP2350_BOOT_GUARD is not set
# CONFIG_SYSTEM_BOOTGUARD is not set

# CONFIG_NET is not set
# CONFIG_SYSTEM_FRUITCLAW is not set
```
